/*
 * Mediatek's MT6757 SoC device tree source
 *
 * Copyright (c) 2013 MediaTek Co., Ltd.
 *              http://www.mediatek.com
 *
 */



#include <dt-bindings/interrupt-controller/arm-gic.h>
#include <dt-bindings/interrupt-controller/irq.h>
#include <dt-bindings/mmc/mt6757-msdc.h>
#include <dt-bindings/clock/mt6757-clk.h>
#include <dt-bindings/pinctrl/mt6757-pinfunc.h>
#include <generated/autoconf.h>
#ifdef CONFIG_MTK_DTBO_FEATURE
/dts-v1/;
#endif

/ {
	model = "MT6757";
	compatible = "mediatek,MT6757";
	interrupt-parent = <&gic>;
	#address-cells = <2>;
	#size-cells = <2>;

	/* chosen */
	chosen: chosen {
		bootargs = "console=tty0 console=ttyMT3,921600n1 \
vmalloc=496M slub_max_order=0 slub_debug=OFZPU \
androidboot.hardware=mt6757 \
firmware_class.path=/vendor/firmware loop.max_part=7";
	};

	/* Do not put any bus before mtk-msdc, because it should be mtk-msdc.0 for partition device node usage */
	mtk-msdc.0 {
		compatible = "simple-bus";
		#address-cells = <1>;
		#size-cells = <1>;
		ranges = <0 0 0 0xffffffff>;

		mmc0: msdc0@11230000 {
			compatible = "mediatek,mt6757-mmc";
			reg = <0x11230000 0x10000>;
			interrupts = <GIC_SPI 79 IRQ_TYPE_LEVEL_LOW>;
			clocks = <&infrasys INFRACFG_AO_MSDC0_CG>;
			clock-names = "MSDC0-CLOCK";
		};

		mmc1: msdc1@11240000 {
			compatible = "mediatek,mt6757-mmc";
			reg = <0x11240000 0x10000>;
			interrupts = <GIC_SPI 80 IRQ_TYPE_LEVEL_LOW>;
			clocks = <&infrasys INFRACFG_AO_MSDC1_CG>;
			clock-names = "MSDC1-CLOCK";
		};

		mmc2: msdc2@11250000 {
			compatible = "mediatek,mt6757-mmc";
			reg = <0x11250000 0x10000>;
			interrupts = <GIC_SPI 81 IRQ_TYPE_LEVEL_LOW>;
			clocks = <&infrasys INFRACFG_AO_MSDC2_CG>;
			clock-names = "MSDC2-CLOCK";
		};
	};

	msdc1_ins: msdc1_ins@0 {
		compatible = "mediatek,mt6757-sdcard-ins";
	};

	/* ATF logger SW IRQ number 318 = 32 + 286 */
	atf_logger {
		compatible = "mediatek,atf_logger";
		interrupts = <GIC_SPI 286 IRQ_TYPE_EDGE_RISING>;
	};

	mobicore {
		compatible = "trustonic,mobicore";
		interrupts = <GIC_SPI 292 IRQ_TYPE_EDGE_RISING>;
	};

	psci {
		compatible	= "arm,psci-0.2";
		method		= "smc";
	};

	/* Microtrust SW IRQ number 289(321) ~ 295(327) */
	utos {
		compatible = "microtrust,utos";
		interrupts = <GIC_SPI 293 IRQ_TYPE_EDGE_RISING>,
			<GIC_SPI 294 IRQ_TYPE_EDGE_RISING>;
	};
	utos_tester {
		compatible = "microtrust,tester-v1";
	};

	cpus {
		#address-cells = <1>;
		#size-cells = <0>;
		cpu0: cpu@000 {
			device_type = "cpu";
			compatible = "arm,cortex-a53";
			reg = <0x000>;
			enable-method = "psci";
			cpu-idle-states = <&LEGACY_MCDI &LEGACY_SODI &LEGACY_SODI3 &LEGACY_DPIDLE>,
					  <&LEGACY_SUSPEND &MCDI_CPU &MCDI_CLUSTER &SODI &SODI3 &DPIDLE &SUSPEND>;
			cpu-release-addr = <0x0 0x40000200>;
			clock-frequency = <1638000000>;
		};
		cpu1: cpu@001 {
			device_type = "cpu";
			compatible = "arm,cortex-a53";
			reg = <0x001>;
			enable-method = "psci";
			cpu-idle-states = <&LEGACY_MCDI &LEGACY_SODI &LEGACY_SODI3 &LEGACY_DPIDLE>,
					  <&LEGACY_SUSPEND &MCDI_CPU &MCDI_CLUSTER &SODI &SODI3 &DPIDLE &SUSPEND>;
			cpu-release-addr = <0x0 0x40000200>;
			clock-frequency = <1638000000>;
		};
		cpu2: cpu@002 {
			device_type = "cpu";
			compatible = "arm,cortex-a53";
			reg = <0x002>;
			enable-method = "psci";
			cpu-idle-states = <&LEGACY_MCDI &LEGACY_SODI &LEGACY_SODI3 &LEGACY_DPIDLE>,
					  <&LEGACY_SUSPEND &MCDI_CPU &MCDI_CLUSTER &SODI &SODI3 &DPIDLE &SUSPEND>;
			cpu-release-addr = <0x0 0x40000200>;
			clock-frequency = <1638000000>;
		};
		cpu3: cpu@003 {
			device_type = "cpu";
			compatible = "arm,cortex-a53";
			reg = <0x003>;
			enable-method = "psci";
			cpu-idle-states = <&LEGACY_MCDI &LEGACY_SODI &LEGACY_SODI3 &LEGACY_DPIDLE>,
					  <&LEGACY_SUSPEND &MCDI_CPU &MCDI_CLUSTER &SODI &SODI3 &DPIDLE &SUSPEND>;
			cpu-release-addr = <0x0 0x40000200>;
			clock-frequency = <1638000000>;
		};
		cpu4: cpu@100 {
			device_type = "cpu";
			compatible = "arm,cortex-a53";
			reg = <0x100>;
			enable-method = "psci";
			cpu-idle-states = <&LEGACY_MCDI &LEGACY_SODI &LEGACY_SODI3 &LEGACY_DPIDLE>,
					  <&LEGACY_SUSPEND &MCDI_CPU &MCDI_CLUSTER &SODI &SODI3 &DPIDLE &SUSPEND>;
			cpu-release-addr = <0x0 0x40000200>;
			clock-frequency = <2340000000>;
		};
		cpu5: cpu@101 {
			device_type = "cpu";
			compatible = "arm,cortex-a53";
			reg = <0x101>;
			enable-method = "psci";
			cpu-idle-states = <&LEGACY_MCDI &LEGACY_SODI &LEGACY_SODI3 &LEGACY_DPIDLE>,
					  <&LEGACY_SUSPEND &MCDI_CPU &MCDI_CLUSTER &SODI &SODI3 &DPIDLE &SUSPEND>;
			cpu-release-addr = <0x0 0x40000200>;
			clock-frequency = <2340000000>;
		};
		cpu6: cpu@102 {
			device_type = "cpu";
			compatible = "arm,cortex-a53";
			reg = <0x102>;
			enable-method = "psci";
			cpu-idle-states = <&LEGACY_MCDI &LEGACY_SODI &LEGACY_SODI3 &LEGACY_DPIDLE>,
					  <&LEGACY_SUSPEND &MCDI_CPU &MCDI_CLUSTER &SODI &SODI3 &DPIDLE &SUSPEND>;
			cpu-release-addr = <0x0 0x40000200>;
			clock-frequency = <2340000000>;
		};
		cpu7: cpu@103 {
			device_type = "cpu";
			compatible = "arm,cortex-a53";
			reg = <0x103>;
			enable-method = "psci";
			cpu-idle-states = <&LEGACY_MCDI &LEGACY_SODI &LEGACY_SODI3 &LEGACY_DPIDLE>,
					  <&LEGACY_SUSPEND &MCDI_CPU &MCDI_CLUSTER &SODI &SODI3 &DPIDLE &SUSPEND>;
			cpu-release-addr = <0x0 0x40000200>;
			clock-frequency = <2340000000>;
		};

		cpu-map {
			cluster0 {
				core0 {
					cpu = <&cpu0>;
				};
				core1 {
					cpu = <&cpu1>;
				};
				core2 {
					cpu = <&cpu2>;
				};
				core3 {
					cpu = <&cpu3>;
				};
			};
			cluster1 {
				core0 {
					cpu = <&cpu4>;
				};
				core1 {
					cpu = <&cpu5>;
				};
				core2 {
					cpu = <&cpu6>;
				};
				core3 {
					cpu = <&cpu7>;
				};
			};
		};

		idle-states {
			entry-method = "arm,psci";

			LEGACY_MCDI: legacy-mcdi {
				compatible = "arm,idle-state";
				arm,psci-suspend-param = <0x0000001>;
				entry-latency-us = <600>;
				exit-latency-us = <600>;
				min-residency-us = <1200>;
			};
			LEGACY_SODI: legacy-sodi {
				compatible = "arm,idle-state";
				arm,psci-suspend-param = <0x0000002>;
				entry-latency-us = <600>;
				exit-latency-us = <600>;
				min-residency-us = <1200>;
			};
			LEGACY_SODI3: legacy-sodi3 {
				compatible = "arm,idle-state";
				arm,psci-suspend-param = <0x0000003>;
				entry-latency-us = <600>;
				exit-latency-us = <600>;
				min-residency-us = <1200>;
			};
			LEGACY_DPIDLE: legacy-dpidle {
				compatible = "arm,idle-state";
				arm,psci-suspend-param = <0x0000004>;
				entry-latency-us = <600>;
				exit-latency-us = <600>;
				min-residency-us = <1200>;
			};
			LEGACY_SUSPEND: legacy-suspend {
				compatible = "arm,idle-state";
				arm,psci-suspend-param = <0x0000005>;
				entry-latency-us = <600>;
				exit-latency-us = <600>;
				min-residency-us = <1200>;
			};
			MCDI_CPU: mcdi-cpu {
				compatible = "arm,idle-state";
				arm,psci-suspend-param = <0x0010001>;
				entry-latency-us = <600>;
				exit-latency-us = <600>;
				min-residency-us = <1200>;
			};
			MCDI_CLUSTER: mcdi-cluster {
				compatible = "arm,idle-state";
				arm,psci-suspend-param = <0x1010001>;
				entry-latency-us = <600>;
				exit-latency-us = <600>;
				min-residency-us = <1200>;
			};
			SODI: sodi {
				compatible = "arm,idle-state";
				arm,psci-suspend-param = <0x1010002>;
				entry-latency-us = <800>;
				exit-latency-us = <1000>;
				min-residency-us = <2000>;
			};
			SODI3: sodi3 {
				compatible = "arm,idle-state";
				arm,psci-suspend-param = <0x1010003>;
				entry-latency-us = <800>;
				exit-latency-us = <1000>;
				min-residency-us = <2000>;
			};
			DPIDLE: dpidle {
				compatible = "arm,idle-state";
				arm,psci-suspend-param = <0x1010004>;
				entry-latency-us = <800>;
				exit-latency-us = <1000>;
				min-residency-us = <2000>;
			};
			SUSPEND: suspend {
				compatible = "arm,idle-state";
				arm,psci-suspend-param = <0x1010005>;
				entry-latency-us = <800>;
				exit-latency-us = <1000>;
				min-residency-us = <2000>;
			};
		};
	};

	memory: memory@40000000 {
		device_type = "memory";
		reg = <0 0x40000000 0 0x20000000>;
	};

	reserved_memory: reserved-memory {
		#address-cells = <2>;
		#size-cells = <2>;
		ranges;

		/* we reserved 2 sections for ATF */
		/* atf-reserved-memory for ATF image, xlat tab, bss, etc. */
		/* atf-ramdump-memory for ATF debug purpose, for ramdump */
		/* We use MPU region 1 to protected these 2 sections */
		/* reserve 64KB at DRAM start + 70MB, for ATF use */
		atf-reserved-memory@0x50e00000 {
			compatible = "mediatek,mt6757-atf-reserved-memory";
			no-map;
			reg = <0 0x50e00000 0 0x14000>;
		};

		/* reserve 192KB after atf-reserved-memory, for ATF ramdump */
		atf-ramdump-memory@50e14000 {
			compatible = "mediatek,mt6757-atf-ramdump-memory";
			no-map;
			reg = <0 0x50e14000 0 0x2c000>;
		};

		ram_console-reserved-memory@47c80000 {
			compatible = "ram_console-reserve-memory";
			reg = <0 0x47c80000 0 0x10000>;
		};

		pstore-reserved-memory@47c90000 {
			compatible = "mediatek,pstore";
			reg = <0 0x47c90000 0 0xe0000>;
		};

		minirdump-reserved-memory@47d70000{
			compatible = "mediatek,minirdump";
			reg = <0 0x47d70000 0 0x10000>;
		};

		consys-reserve-memory {
			compatible = "mediatek,consys-reserve-memory";
			#address-cells = <2>;
			#size-cells = <2>;
			no-map;
			size = <0 0x200000>;
			alignment = <0 0x200000>;
			alloc-ranges = <0 0x40000000 0 0x80000000>;
		};

		spm-reserve-memory {
			compatible = "mediatek,spm-reserve-memory";
			no-map;
			size = <0 0x38000>; /* PCM_FIRMWARE_SIZE x DYNA_LOAD_PCM_MAX = 16KB x 14 */
			alignment = <0 0x10000>;
			alloc-ranges = <0 0x40000000 0 0x80000000>;
		};
#ifdef CONFIG_MICROTRUST_TEE_SUPPORT
		soter-shared-mem {
			compatible = "microtrust,shared_mem";
			no-map;
			size = <0 0x200000>;
			alloc-ranges = <0 0x40000000 0 0x50000000>;
		};
#endif
	};

	plat_sram_flag@0011dbf0 {
		compatible = "mediatek,plat_sram_flag";
		reg = <0 0x0011dbf0 0 0x10>;
	};

	gic: interrupt-controller@0c000000 {
		compatible = "arm,gic-v3";
		#interrupt-cells = <3>;
		#address-cells = <2>;
		#size-cells = <2>;
		#redistributor-regions = <1>;
		interrupt-controller;
		reg = <0 0x0c000000 0 0x40000>, // distributor
			<0 0x0c200000 0 0x200000>, // redistributor
			<0 0x10200620 0 0x001000>, // INTPOL0
			<0 0x10200690 0 0x001000>; // INTPOL1
		interrupts = <GIC_PPI 9 IRQ_TYPE_LEVEL_HIGH>;

		mediatek,reg_len_pol0 = <8>; // 8*32 irq polarity setting in INTPOL0
	};

	clocks {
		clk_null: clk_null {
			compatible = "fixed-clock";
			#clock-cells = <0>;
			clock-frequency = <0>;
		};

		clk26m: clk26m {
			compatible = "fixed-clock";
			#clock-cells = <0>;
			clock-frequency = <26000000>;
		};

		clk32k: clk32k {
			compatible = "fixed-clock";
			#clock-cells = <0>;
			clock-frequency = <32000>;
		};
	};

	cpuxgpt@10200000 {
		compatible = "mediatek,cpuxgpt";
		reg = <0 0x10200000 0 0x1000>;
		interrupts = <GIC_SPI 64 IRQ_TYPE_LEVEL_HIGH>,
			     <GIC_SPI 65 IRQ_TYPE_LEVEL_HIGH>,
			     <GIC_SPI 66 IRQ_TYPE_LEVEL_HIGH>,
			     <GIC_SPI 67 IRQ_TYPE_LEVEL_HIGH>,
			     <GIC_SPI 68 IRQ_TYPE_LEVEL_HIGH>,
			     <GIC_SPI 69 IRQ_TYPE_LEVEL_HIGH>,
			     <GIC_SPI 70 IRQ_TYPE_LEVEL_HIGH>,
			     <GIC_SPI 71 IRQ_TYPE_LEVEL_HIGH>;
	};
	
	aw87319_pa:aw87319_pa@ {
		compatible = "mediatek,aw87319_pa";
	};

	pmu {
		compatible = "arm,armv8-pmuv3";
		interrupts = <GIC_PPI 7 IRQ_TYPE_LEVEL_LOW>;
	};


	timer: timer {
		compatible = "arm,armv8-timer";
		interrupts = <GIC_PPI 13 IRQ_TYPE_LEVEL_LOW>,
			     <GIC_PPI 14 IRQ_TYPE_LEVEL_LOW>,
			     <GIC_PPI 11 IRQ_TYPE_LEVEL_LOW>,
			     <GIC_PPI 10 IRQ_TYPE_LEVEL_LOW>;
		clock-frequency = <13000000>;
	};

	mtkfb: mtkfb@0 {
		compatible = "mediatek,mtkfb";
	};

	touch: touch {
		compatible = "mediatek,mt6757-touch";
		/* VTOUCH-supply = <&mt_pmic_vgp1_ldo_reg>; */
	};

	accdet: accdet@ {
		compatible = "mediatek,mt6757-accdet";
	};

	bat_notify {
		compatible = "mediatek,bat_notify";
	};

	bat_metter {
		compatible = "mediatek,bat_meter";
		/* cust_charging.h */
		/* stop charging while in talking mode */
		stop_charging_in_takling = <1 >;
		talking_recharge_voltage = <3800 >;
		talking_sync_time = <60 >;

		/* Battery Temperature Protection */
		mtk_temperature_recharge_support = <1 >;
		max_charge_temperature = <50 >;
		max_charge_temperature_minus_x_degree = <47 >;
		min_charge_temperature = <0 >;
		min_charge_temperature_plus_x_degree = <6 >;
		err_charge_temperature = <0xff >;

		/* Linear Charging Threshold */
		v_pre2cc_thres = <3400 >;	/* unit: mV */
		v_cc2topoff_thres = <4050 >;
		recharging_voltage = <4110 >;
		charging_full_current = <100 >;	/* unit: mA */

		/* Charging Current Setting */
		config_usb_if = <0 >;
		usb_charger_current_suspend = <0 >;	/* Unit: 0.01 mA */
		usb_charger_current_unconfigured = <7000 >;	/* Unit: 0.01 mA */
		usb_charger_current_configured = <50000 >;	/* Unit: 0.01 mA */
		usb_charger_current = <50000 >;	/* Unit: 0.01 mA */
		ac_charger_current = <80000 >;	/* Unit: 0.01 mA */
		non_std_ac_charger_current = <50000 >;	/* Unit: 0.01 mA */
		charging_host_charger_current = <65000 >;	/* Unit: 0.01 mA */
		apple_0_5a_charger_current = <50000 >;	/* Unit: 0.01 mA */
		apple_1_0a_charger_current = <65000 >;	/* Unit: 0.01 mA */
		apple_2_1a_charger_current = <80000 >;	/* Unit: 0.01 mA */


		/* charger error check */
		bat_low_temp_protect_enable = <0 >;
		v_charger_enable = <0 >;	/* 1:on , 0:off */
		v_charger_max = <6500 >;	/* unit: mV */
		v_charger_min = <4400 >;

		/*  Tracking TIME */
		onehundred_percent_tracking_time = <10 >;	/* Unit: second */
		npercent_tracking_time = <20 >;	/* Unit: second */
		sync_to_real_tracking_time = <60 >;	/* Unit: second */
		v_0percent_tracking = <3450 >;	/* Unit: mV */

		/* High battery support */
		high_battery_voltage_support = <0 >;

		/* cust_battery_meter.h */
		/* ADC resistor  */
		r_bat_sense = <4 >;
		r_i_sense = <4 >;
		r_charger_1 = <330 >;
		r_charger_2 = <39 >;
		temperature_t0 = <110 >;
		temperature_t1 = <0 >;
		temperature_t2 = <25 >;
		temperature_t3 = <50 >;
		temperature_t = <255 >;	/* this should be fixed, never change the value */
		fg_meter_resistance = <0 >;

		/* Qmax for 0mA */
		q_max_pos_50 = <2743 >;
		q_max_pos_25 = <2707 >;
		q_max_pos_0 = <840 >;
		q_max_neg_10 = <807 >;
		/* Qmax for 400mA, said high current */
		q_max_pos_50_h_current = <2688 >;
		q_max_pos_25_h_current = <2653 >;
		q_max_pos_0_h_current = <823 >;
		q_max_neg_10_h_current = <791 >;
		/* Discharge percentage, 1: D5, 0: D2 */
		oam_d5 = <1 >;

		change_tracking_point = <1 >;
		/* SW OCV tracking setting */
		cust_tracking_point = <0 >;
		cust_r_sense = <56 >;
		cust_hw_cc = <0 >;
		aging_tuning_value = <103 >;
		cust_r_fg_offset = <0 >;
		ocv_board_compesate = <0 >;
		r_fg_board_base = <1000 >;
		r_fg_board_slope = <1000 >;
		car_tune_value = <118 >;

		/* HW Fuel gague  */
		current_detect_r_fg = <10 >;	/* Unit: mA */
		minerroroffset = <1000 >;
		fg_vbat_average_size = <18 >;
		r_fg_value = <10 >;	/* Unit: mOhm */

		/* HW Fuel gague 2.0*/
		difference_hwocv_rtc = <30 >;
		difference_hwocv_swocv = <10>;
		difference_swocv_rtc = <10>;
		max_swocv = <3>;

		difference_voltage_update = <20>;
		aging1_load_soc = <70>;
		aging1_update_soc = <30>;
		batterypseudo100 = <95>;
		batterypseudo1 = <11>;

		q_max_by_sys = <1>;			/*8. qmax variant by system drop voltage.*/
		q_max_sys_voltage = <3350>;
		shutdown_gauge0 = <1>;
		shutdown_gauge1_xmins = <1>;
		shutdown_gauge1_mins = <60>;

		shutdown_system_voltage = <3400>;
		charge_tracking_time = <60>;
		discharge_tracking_time = <10>;

		recharge_tolerance = <10>;

		sync_ui_soc_imm =<0>;
		mtk_enable_aging_algorithm = <1>;
		md_sleep_current_check = <1>;
		q_max_by_current = <0>;

		/* HW Fuel gague 1.0*/
		cust_poweron_delta_capacity_tolrance = <40 >;
		cust_poweron_low_capacity_tolrance = <5 >;
		cust_poweron_max_vbat_tolrance = <90 >;
		cust_poweron_delta_vbat_tolrance = <30 >;
		cust_poweron_delta_hw_sw_ocv_capacity_tolrance = <10 >;

		/* Fixed battery temperature */
		fixed_tbat_25 = <0 >;
		/* Dynamic change wake up period of battery thread when suspend */
		vbat_normal_wakeup = <3600 >;	/* Unit: mV */
		vbat_low_power_wakeup = <3500 >;	/* Unit: mV */
		normal_wakeup_period = <5400 >;	/* Unit: second */
		low_power_wakeup_period = <300 >;	/* Unit: second */
		close_poweroff_wakeup_period = <30 >;	/* Unit: second */

		rbat_pull_up_r = <24000 >;
		rbat_pull_up_volt = <1800 >;


		batt_temperature_table_num = <17 >;
		batt_temperature_table = <0xffffffec 0x10a8d 0xfffffff1 0xd192 0xfffffff6 0xa60a 0xfffffffb 0x8464 0x0 0x6a53 0x5 0x5605 0xa 0x4606 0xf 0x3952 0x14 0x2f31 0x19 0x2710 0x1e 0x207b 0x23 0x1b24 0x28 0x16ca 0x2d 0x1335 0x32 0x1041 0x37 0xdcf 0x3c 0xbc6>;
		battery_profile_t0 = <0x0 0x10cf 0x6 0x10b9 0xd 0x10a5 0x12 0x1090 0x19 0x1079 0x1f 0x1062 0x26 0x1049 0x2c 0x1031 0x33 0x1015 0x38 0xff8 0x3e 0xfe4 0x45 0xfcf 0x4b 0xfb3 0x52 0xf9d 0x57 0xf8d 0x5e 0xf7f 0x64 0xf74 0x6b 0xf66 0x71 0xf59 0x76 0xf49 0x7d 0xf37 0x80 0xf28 0x87 0xf1d 0x8d 0xf11 0x93 0xf08 0x9a 0xeff 0x9f 0xef6 0xa6 0xeef 0xac 0xeea 0xb3 0xee3 0xb9 0xede 0xc0 0xed8 0xc5 0xed4 0xcb 0xecf 0xd2 0xecb 0xd8 0xec5 0xdf 0xebf 0xe4 0xeba 0xeb 0xeb0 0xf1 0xea8 0xf8 0xe9e 0xfe 0xe93 0x103 0xe89 0x10a 0xe81 0x110 0xe78 0x117 0xe72 0x11d 0xe68 0x124 0xe51 0x129 0xe1d 0x130 0xdc6 0x133 0xd8a 0x136 0xd74 0x139 0xd60 0x139 0xd4c>;
		battery_profile_t1_num = <82 >;
		battery_profile_t1 = <0x0 0x10dc 0x7 0x10bb 0xc 0x1094 0x14 0x1072 0x16 0x1059 0x1d 0x1044 0x22 0x1030 0x29 0x1020 0x31 0x100d 0x36 0xffd 0x3d 0xff0 0x3f 0xfe5 0x47 0xfcf 0x4e 0xfb7 0x53 0xfa3 0x5a 0xf95 0x5f 0xf89 0x64 0xf7f 0x69 0xf73 0x70 0xf64 0x78 0xf53 0x7c 0xf43 0x84 0xf33 0x8b 0xf25 0x8d 0xf18 0x95 0xf0f 0x9a 0xf06 0xa1 0xefd 0xa6 0xef7 0xad 0xeef 0xb5 0xee7 0xb7 0xee3 0xbe 0xedc 0xc3 0xed7 0xca 0xed2 0xd2 0xece 0xd7 0xec9 0xde 0xec6 0xe0 0xec2 0xe8 0xebd 0xed 0xeb8 0xf4 0xeb1 0xfb 0xea9 0x100 0xe9e 0x105 0xe8f 0x10a 0xe80 0x111 0xe78 0x116 0xe75 0x11d 0xe72 0x125 0xe6c 0x12a 0xe60 0x12e 0xe29 0x133 0xdc8 0x13b 0xd90 0x142 0xd4b 0x144 0xcfb 0x144 0xcc3 0x144 0xc9e 0x147 0xc83 0x147 0xc6c 0x147 0xc55 0x147 0xc45 0x147 0xc34 0x147 0xc25 0x147 0xc18 0x147 0xc0c 0x147 0xc07 0x147 0xbfb 0x147 0xbf2 0x147 0xbe7 0x147 0xbe1 0x147 0xbd8 0x147 0xbd5 0x147 0xbca 0x147 0xbc0 0x147 0xbba 0x147 0xbbb 0x147 0xbb3 0x147 0xba9 0x147 0xba7 0x147 0xba3 0x147 0xb97>;
		battery_profile_t2_num = <82 >;
		battery_profile_t2 = <0x0 0x10e8 0x2 0x10cf 0x4 0x10bb 0x5 0x10a7 0x7 0x1095 0x9 0x1083 0xb 0x1071 0xd 0x105d 0xe 0x104d 0x10 0x103b 0x13 0x102a 0x15 0x1019 0x16 0x1008 0x18 0xff7 0x1a 0xfe8 0x1c 0xfda 0x1e 0xfc9 0x1f 0xfb9 0x21 0xfab 0x23 0xf9c 0x25 0xf8f 0x27 0xf84 0x28 0xf76 0x2a 0xf69 0x2c 0xf56 0x2e 0xf43 0x30 0xf31 0x31 0xf24 0x34 0xf19 0x36 0xf0e 0x38 0xf06 0x39 0xf00 0x3b 0xef8 0x3d 0xef0 0x3f 0xeea 0x41 0xee5 0x42 0xedd 0x44 0xed9 0x46 0xed2 0x48 0xecd 0x4a 0xec8 0x4b 0xec2 0x4d 0xebc 0x4f 0xeb5 0x51 0xea9 0x54 0xea1 0x55 0xe95 0x57 0xe85 0x59 0xe73 0x5b 0xe6c 0x5c 0xe6b 0x5e 0xe69 0x60 0xe67 0x62 0xe54 0x64 0xe0d 0x65 0xda9 0x67 0xd3f 0x68 0xc55 0x69 0xc01 0x69 0xbce 0x69 0xbb0 0x69 0xb99 0x69 0xb8e 0x69 0xb82 0x69 0xb76 0x69 0xb6d 0x69 0xb61 0x69 0xb5e 0x69 0xb54 0x69 0xb4b 0x69 0xb4b 0x69 0xb4b 0x69 0xb4b 0x69 0xb4b 0x69 0xb4b 0x69 0xb4b 0x69 0xb4b 0x69 0xb4b 0x69 0xb4b 0x69 0xb4b 0x69 0xb4b 0x69 0xb4b>;
		battery_profile_t3_num = <82 >;
		battery_profile_t3 = <0x0 0x10eb 0x2 0x10d1 0x3 0x10bc 0x5 0x10a9 0x7 0x1094 0xa 0x1081 0xb 0x106e 0xd 0x105c 0xf 0x104a 0x10 0x1039 0x12 0x1027 0x14 0x1017 0x16 0x1006 0x17 0xff5 0x1a 0xfe5 0x1c 0xfd6 0x1d 0xfc6 0x1f 0xfb7 0x21 0xfaa 0x23 0xf9c 0x24 0xf90 0x26 0xf82 0x28 0xf76 0x29 0xf6b 0x2c 0xf5e 0x2e 0xf51 0x2f 0xf40 0x31 0xf2c 0x33 0xf1c 0x35 0xf11 0x36 0xf08 0x38 0xefe 0x3b 0xef8 0x3c 0xef0 0x3e 0xee9 0x40 0xee3 0x42 0xede 0x43 0xed8 0x45 0xed2 0x47 0xece 0x48 0xec8 0x4a 0xec1 0x4d 0xeb3 0x4f 0xeae 0x50 0xea6 0x52 0xe9e 0x54 0xe95 0x55 0xe8b 0x57 0xe7d 0x59 0xe6e 0x5b 0xe5e 0x5d 0xe5c 0x5f 0xe5b 0x61 0xe5a 0x62 0xe55 0x64 0xe29 0x66 0xddb 0x68 0xda7 0x69 0xd82 0x6b 0xd03 0x6d 0xc44 0x6d 0xc06 0x6d 0xbd9 0x6d 0xbb9 0x6d 0xba4 0x6e 0xb90 0x6e 0xb80 0x6e 0xb74 0x6e 0xb69 0x6e 0xb61 0x6e 0xb57 0x6e 0xb53 0x6e 0xb49 0x6e 0xb49 0x6e 0xb49 0x6e 0xb49 0x6e 0xb49 0x6e 0xb49 0x6e 0xb49 0x6e 0xb49 0x6e 0xb49 0x6e 0xb49>;

		r_profile_t0_num = <82 >;
		r_profile_t0 = <0x198 0x10cf 0x198 0x10b9 0x19f 0x10a5 0x1a9 0x1090 0x1ae 0x1079 0x1b8 0x1062 0x1cf 0x1049 0x1ea 0x1031 0x20d 0x1015 0x23d 0xff8 0x267 0xfe4 0x28a 0xfcf 0x2a3 0xfb3 0x2ad 0xf9d 0x2c1 0xf8d 0x2c9 0xf7f 0x2d0 0xf74 0x2dd 0xf66 0x2d8 0xf59 0x2e2 0xf49 0x2d5 0xf37 0x2df 0xf28 0x2e9 0xf1d 0x2ec 0xf11 0x2f8 0xf08 0x305 0xeff 0x30f 0xef6 0x323 0xeef 0x334 0xeea 0x343 0xee3 0x35f 0xede 0x378 0xed8 0x387 0xed4 0x39d 0xecf 0x3bb 0xecb 0x3cf 0xec5 0x3e8 0xebf 0x40b 0xeba 0x422 0xeb0 0x442 0xea8 0x451 0xe9e 0x46f 0xe93 0x490 0xe89 0x4ba 0xe81 0x4e7 0xe78 0x541 0xe72 0x596 0xe68 0x5ee 0xe51 0x622 0xe1d 0x652 0xdc6 0x684 0xd8a 0x64d 0xd74 0x61b 0xd60 0x5e6 0xd4c 0x5b4 0xd35 0x578 0xd1d 0x535 0xd04 0x503 0xcee 0x4d1 0xcdb 0x4ae 0xcca 0x483 0xcbb 0x468 0xcad 0x445 0xca2 0x433 0xc95 0x41d 0xc8c 0x3ff 0xc84 0x3fa 0xc79 0x3ed 0xc72 0x3d2 0xc6b 0x3c0 0xc60 0x3ac 0xc5a 0x37f 0xc55 0x37a 0xc4f 0x35f 0xc47 0x39d 0xc3d 0x37d 0xc35 0x37d 0xc35 0x37d 0xc35 0x37d 0xc35 0x37d 0xc35 0x37d 0xc35 0x37d 0xc35>;
		r_profile_t1_num = <82 >;
		r_profile_t1 = <0x102 0x10dc 0x102 0x10bb 0x116 0x1094 0x12f 0x1072 0x14d 0x1059 0x157 0x1044 0x15e 0x1030 0x16d 0x1020 0x172 0x100d 0x172 0xffd 0x17c 0xff0 0x193 0xfe5 0x18b 0xfcf 0x193 0xfb7 0x193 0xfa3 0x19d 0xf95 0x1a2 0xf89 0x1a4 0xf7f 0x1a7 0xf73 0x19f 0xf64 0x19a 0xf53 0x190 0xf43 0x189 0xf33 0x189 0xf25 0x184 0xf18 0x18b 0xf0f 0x193 0xf06 0x195 0xefd 0x19f 0xef7 0x1a9 0xeef 0x1ae 0xee7 0x1bb 0xee3 0x1c2 0xedc 0x1d1 0xed7 0x1db 0xed2 0x1e3 0xece 0x1ea 0xec9 0x1f7 0xec6 0x208 0xec2 0x215 0xebd 0x221 0xeb8 0x233 0xeb1 0x24c 0xea9 0x258 0xe9e 0x260 0xe8f 0x267 0xe80 0x27b 0xe78 0x29e 0xe75 0x2c6 0xe72 0x2fd 0xe6c 0x348 0xe60 0x370 0xe29 0x393 0xdc8 0x438 0xd90 0x52b 0xd4b 0x523 0xcfb 0x49c 0xcc3 0x438 0xc9e 0x3f2 0xc83 0x3be 0xc6c 0x39d 0xc55 0x378 0xc45 0x35c 0xc34 0x32a 0xc25 0x314 0xc18 0x2fd 0xc0c 0x2bc 0xc07 0x2e9 0xbfb 0x2a8 0xbf2 0x2ad 0xbe7 0x28a 0xbe1 0x2ab 0xbd8 0x267 0xbd5 0x283 0xbca 0x294 0xbc0 0x27b 0xbba 0x212 0xbbb 0x280 0xbb3 0x253 0xba9 0x217 0xba7 0x1cf 0xba3 0x258 0xb97>;
		r_profile_t2_num = <82 >;
		r_profile_t2 = <0x9b 0x10e8 0x9b 0x10cf 0x9b 0x10bb 0x9e 0x10a7 0x9e 0x1095 0xa3 0x1083 0xa5 0x1071 0xa5 0x105d 0xaa 0x104d 0xaa 0x103b 0xad 0x102a 0xad 0x1019 0xad 0x1008 0xb2 0xff7 0xb4 0xfe8 0xb9 0xfda 0xbc 0xfc9 0xbe 0xfb9 0xc8 0xfab 0xc8 0xf9c 0xcd 0xf8f 0xda 0xf84 0xd7 0xf76 0xd7 0xf69 0xc8 0xf56 0xbc 0xf43 0xad 0xf31 0xa8 0xf24 0xa3 0xf19 0xa0 0xf0e 0xa3 0xf06 0xa8 0xf00 0xaa 0xef8 0xaa 0xef0 0xaa 0xeea 0xb2 0xee5 0xaf 0xedd 0xb7 0xed9 0xb4 0xed2 0xb7 0xecd 0xb9 0xec8 0xb7 0xec2 0xb9 0xebc 0xb7 0xeb5 0xad 0xea9 0xad 0xea1 0xad 0xe95 0xad 0xe85 0xad 0xe73 0xaa 0xe6c 0xaf 0xe6b 0xb9 0xe69 0xc6 0xe67 0xcd 0xe54 0xd0 0xe0d 0xf0 0xda9 0x111 0xd3f 0x38c 0xc55 0x2c1 0xc01 0x253 0xbce 0x201 0xbb0 0x1d1 0xb99 0x19d 0xb8e 0x17c 0xb82 0x170 0xb76 0x168 0xb6d 0x14f 0xb61 0x113 0xb5e 0x13b 0xb54 0x11b 0xb4b 0x11b 0xb4b 0x11b 0xb4b 0x11b 0xb4b 0x11b 0xb4b 0x11b 0xb4b 0x11b 0xb4b 0x11b 0xb4b 0x11b 0xb4b 0x11b 0xb4b 0x11b 0xb4b 0x11b 0xb4b 0x11b 0xb4b>;
		r_profile_t3_num = <82 >;
		r_profile_t3 = <0x7b 0x10eb 0x7b 0x10d1 0x80 0x10bc 0x82 0x10a9 0x82 0x1094 0x82 0x1081 0x80 0x106e 0x7d 0x105c 0x82 0x104a 0x85 0x1039 0x85 0x1027 0x8a 0x1017 0x8a 0x1006 0x8c 0xff5 0x8c 0xfe5 0x8f 0xfd6 0x8c 0xfc6 0x8f 0xfb7 0x94 0xfaa 0x99 0xf9c 0x9b 0xf90 0x9b 0xf82 0xa5 0xf76 0xaf 0xf6b 0xaf 0xf5e 0xb2 0xf51 0xaa 0xf40 0x94 0xf2c 0x87 0xf1c 0x87 0xf11 0x85 0xf08 0x85 0xefe 0x87 0xef8 0x87 0xef0 0x87 0xee9 0x8f 0xee3 0x91 0xede 0x94 0xed8 0x91 0xed2 0x99 0xece 0x96 0xec8 0x96 0xec1 0x85 0xeb3 0x8f 0xeae 0x8c 0xea6 0x8a 0xe9e 0x87 0xe95 0x87 0xe8b 0x85 0xe7d 0x85 0xe6e 0x82 0xe5e 0x82 0xe5c 0x8a 0xe5b 0x94 0xe5a 0xa0 0xe55 0x9e 0xe29 0xaa 0xddb 0xd0 0xda7 0xdc 0xd82 0x109 0xd03 0x357 0xc44 0x2d5 0xc06 0x258 0xbd9 0x210 0xbb9 0x1cc 0xba4 0x190 0xb90 0x17c 0xb80 0x163 0xb74 0x13b 0xb69 0x12f 0xb61 0x134 0xb57 0xff 0xb53 0x111 0xb49 0x111 0xb49 0x111 0xb49 0x111 0xb49 0x111 0xb49 0x111 0xb49 0x111 0xb49 0x111 0xb49 0x111 0xb49 0x111 0xb49>;
	};
	
	mt6355_gauge {
		compatible = "mediatek,mt6355_gauge";
		gauge_name = "gauge";
		alias_name = "MT6355";
	};

	gauge_timer {
		compatible = "mediatek,gauge_timer_service";
	};

#if (CONFIG_MTK_GAUGE_VERSION == 30)
	#if (CONFIG_MTK_ADDITIONAL_BATTERY_TABLE == 1)
		#include "bat_setting/mt6757_battery_prop_ext.dtsi"
	#else
		#include "bat_setting/mt6757_battery_prop.dtsi"
	#endif
#endif

	mt_charger: mt_charger {
		compatible = "mediatek,mt-charger";
	};

	swtp: swtp {
		compatible = "mediatek, swtp-eint";
	};

	pmic_clock_buffer_ctrl:pmic_clock_buffer {
		compatible = "mediatek,pmic_clock_buffer";
		mediatek,clkbuf-quantity = <4>;
		mediatek,clkbuf-config = <2 1 1 2>;
		mediatek,clkbuf-driving-current = <2 2 2 2>;
	};

	usbphy0:usbphy@0 {
		 compatible = "usb-nop-xceiv";
	};

	chipid@08000000 {
		compatible = "mediatek,chipid";
		reg = <0 0x08000000 0 0x0004>,
				<0 0x08000004 0 0x0004>,
				<0 0x08000008 0 0x0004>,
				<0 0x0800000C 0 0x0004>;
	};

	gic500@0c000000 {
		compatible = "mediatek,gic500";
		reg = <0 0x0c000000 0 0x400000>;
	};

	gic_cpu@0c400000 {
		compatible = "mediatek,gic_cpu";
		reg = <0 0x0c400000 0 0x40000>;
	};

	dfd@0c600000 {
		compatible = "mediatek,dfd";
		reg = <0 0x0c600000 0 0x100000>;

		mediatek,enabled = <1>;
		mediatek,chain_length = <0x000061a8>;
		mediatek,rg_dfd_timeout = <0x2>;
	};

	dbg_etb@0d010000 {
		compatible = "mediatek,dbg_etb";
		reg = <0 0x0d010000 0 0x10000>;
	};

	dbg_cti@0d020000 {
		compatible = "mediatek,dbg_cti";
		reg = <0 0x0d020000 0 0x10000>;
	};

	dbg_etr@0d030000 {
		compatible = "mediatek,dbg_etr";
		reg = <0 0x0d030000 0 0x10000>;
	};

	dbg_funnel@0d040000 {
		compatible = "mediatek,dbg_funnel";
		reg = <0 0x0d040000 0 0x10000>;
	};

	dbg_dem@0d0a0000 {
		compatible = "mediatek,dbg_dem";
		reg = <0 0x0d0a0000 0 0x10000>;
	};

	dbg_mdsys1@0d0c0000 {
		compatible = "mediatek,dbg_mdsys1";
		reg = <0 0x0d0c0000 0 0x40000>;
	};

	dbg_apmcu_mp0@0d400000 {
		compatible = "mediatek,dbg_apmcu_mp0";
		reg = <0 0x0d400000 0 0x400000>;
	};

	dbg_apmcu_mp1@0d800000 {
		compatible = "mediatek,dbg_apmcu_mp1";
		reg = <0 0x0d800000 0 0x400000>;
	};

	cpu_dbgapb: cpu_dbgapb {
		compatible = "mediatek,hw_dbg";
		num = <8>;
		reg =  <0 0x0d410000 0 0x1000
			0 0x0d510000 0 0x1000
			0 0x0d610000 0 0x1000
			0 0x0d710000 0 0x1000
			0 0x0d810000 0 0x1000
			0 0x0d910000 0 0x1000
			0 0x0da10000 0 0x1000
			0 0x0db10000 0 0x1000>;
	};

	topckgen: topckgen@10000000 {
		compatible = "mediatek,topckgen";
		reg = <0 0x10000000 0 0x1000>;
		#clock-cells = <1>;
	};

	usb2jtag: usb2jtag@10001000 {
		compatible = "mediatek,usb2jtag_v1";
		reg = <0 0x10001000 0 0x1000>,
			<0 0x11290000 0 0x1000>,
			<0 0x11210000 0 0x1000>;
	};

	infrasys: infracfg_ao@10001000 {
		compatible = "mediatek,infracfg_ao";
		reg = <0 0x10001000 0 0x1000>;
		interrupts = <GIC_SPI 136 IRQ_TYPE_EDGE_RISING>;
		#clock-cells = <1>;
	};

	btcvsd@10001000 {
		compatible = "mediatek,audio_bt_cvsd";
		offset =<0xf00 0x800 0xfd0 0xfd4 0xfd8>;
		/*INFRA MISC, conn_bt_cvsd_mask, cvsd_mcu_read, write, packet_indicator*/
		reg=<0 0x10001000 0 0x1000>, /*AUDIO_INFRA_BASE_PHYSICAL*/
			  <0 0x18000000 0 0x10000>, /*PKV_PHYSICAL_BASE*/
			  <0 0x18080000 0 0x8000>; /*SRAM_BANK2*/
		interrupts = <GIC_SPI 265 IRQ_TYPE_LEVEL_LOW>;
	};

	scpsys: scpsys@10001000 {
		compatible = "mediatek,mt6757-scpsys";
		reg = <0 0x10001000 0 0x1000>,
				<0 0x10006000 0 0x1000>,
				<0 0x1020e000 0 0x1000>,
				<0 0x10000000 0 0x1000>;
		#clock-cells = <1>;
	};

	iocfg_0@10002000 {
		compatible = "mediatek,iocfg_0";
		reg = <0 0x10002000 0 0x200>;
	};

	syscfg_pctl_a: syscfg_pctl_a@10002000 {
		compatible = "mediatek,mt6757-pctl-a-syscfg", "syscon";
		reg = <0 0x10002000 0 0x1000>;
	};

	iocfg_1@10002200 {
		compatible = "mediatek,iocfg_1";
		reg = <0 0x10002200 0 0x200>;
	};

	iocfg_2@10002400 {
		compatible = "mediatek,iocfg_2";
		reg = <0 0x10002400 0 0x200>;
	};

	iocfg_3@10002600 {
		compatible = "mediatek,iocfg_3";
		reg = <0 0x10002600 0 0x200>;
	};

	iocfg_4@10002800 {
		compatible = "mediatek,iocfg_4";
		reg = <0 0x10002800 0 0x200>;
	};

	iocfg_5@10002a00 {
		compatible = "mediatek,iocfg_5";
		reg = <0 0x10002a00 0 0x200>;
	};

	pericfg@10003000 {
		compatible = "mediatek,pericfg";
		reg = <0 0x10003000 0 0x1000>;
	};

	pio: pinctrl@10005000 {
		compatible = "mediatek,mt6757-pinctrl";
		reg = <0 0x10005000 0 0x1000>;
		mediatek,pctl-regmap = <&syscfg_pctl_a>;
		pins-are-numbered;
		gpio-controller;
		#gpio-cells = <2>;
	};

	gpio_usage_mapping:gpio {
		compatible = "mediatek,gpio_usage_mapping";
	};

	gpio@10005000 {
		compatible = "mediatek,gpio";
		reg = <0 0x10005000 0 0x1000>;
	};

	sleep@10006000 {
		compatible = "mediatek,sleep";
		reg = <0 0x10006000 0 0x1000>,
		      <0 0x0011cf80 0 0x80>;
		interrupts = <GIC_SPI 165 IRQ_TYPE_LEVEL_LOW>,
			     <GIC_SPI 166 IRQ_TYPE_LEVEL_LOW>,
			     <GIC_SPI 167 IRQ_TYPE_LEVEL_LOW>,
			     <GIC_SPI 168 IRQ_TYPE_LEVEL_LOW>,
			     <GIC_SPI 169 IRQ_TYPE_LEVEL_LOW>,
			     <GIC_SPI 170 IRQ_TYPE_LEVEL_LOW>,
			     <GIC_SPI 171 IRQ_TYPE_LEVEL_LOW>,
			     <GIC_SPI 172 IRQ_TYPE_LEVEL_LOW>;
	};

	toprgu@10007000 {
		compatible = "mediatek,mt6757-toprgu";
		reg = <0 0x10007000 0 0x1000>;
		interrupts = <GIC_SPI 130 IRQ_TYPE_EDGE_FALLING>;
	};

	apxgpt@10008000 {
		compatible = "mediatek,mt6757-timer",
			     "mediatek,mt6577-timer";
		reg = <0 0x10008000 0 0x1000>;
		interrupts = <GIC_SPI 154 IRQ_TYPE_LEVEL_LOW>;
		clocks = <&topckgen INFRACFG_AO_CLK_13M>,
			 <&clk32k>;
	};

	hacc@1000a000 {
		compatible = "mediatek,hacc";
		reg = <0 0x1000a000 0 0x1000>;
		interrupts = <GIC_SPI 173 IRQ_TYPE_LEVEL_LOW>;
	};

	eintc: eintc@1000b000 {
		compatible = "mediatek,mt-eic";
		reg = <0 0x1000b000 0 0x1000>;
		interrupts = <GIC_SPI 155 IRQ_TYPE_LEVEL_HIGH>;
		mediatek,max_hw_deb_cnt = <16>;
		/* mediatek,builtin_eint_hw_deb = <145 8 0x90>; */
		mediatek,max_deint_cnt = <4>;
		mediatek,deint_possible_irq = <191 192 193 194>;
		#interrupt-cells = <2>;
		interrupt-controller;
		mediatek,max_eint_num = <160>;
		mediatek,mapping_table_entry = <0>;
		mediatek,debtime_setting_entry = <10>;
		mediatek,debtime_setting_array	= <0 128>,
						<1 256>,
						<2 512>,
						<3 1024>,
						<4 16384>,
						<5 32768>,
						<6 65536>,
						<7 131072>,
						<8 262144>,
						<9 524288>;
	};

	apmixedsys: apmixed@1000c000 {
		compatible = "mediatek,apmixed";
		reg = <0 0x1000c000 0 0xf00>, <0 0x10006000 0 0x1000>;
		#clock-cells = <1>;
	};

	fhctl@1000ce00 {
		compatible = "mediatek,fhctl";
		reg = <0 0x1000ce00 0 0x100>;
	};

	pwrap@1000d000 {
		compatible = "mediatek,pwrap";
		reg = <0 0x1000d000 0 0x1000>;
		interrupts = <GIC_SPI 163 IRQ_TYPE_LEVEL_HIGH>;
		mt6355_pmic: mt6355 {
			compatible = "mediatek,mt6355-pmic";
			interrupt-controller;
		};
	};

	devapc_ao@1000e000 {
		compatible = "mediatek,devapc_ao";
		reg = <0 0x1000e000 0 0x1000>;
	};

	mrdump_ext_rst: mrdump_ext_rst {
		compatible = "mediatek, mrdump_ext_rst-eint";
		source = "EINT";
		mode = "IRQ";
		status = "okay";
	};

	keypad: keypad@10010000 {
		compatible = "mediatek,mt6757-keypad";
		reg = <0 0x10010000 0 0x1000>;
		interrupts = <GIC_SPI 164 IRQ_TYPE_EDGE_FALLING>;
	};

	topmisc@10011000 {
		compatible = "mediatek,topmisc";
		reg = <0 0x10011000 0 0x1000>;
	};

	mdcldma:mdcldma@10014000 {
		compatible = "mediatek,mdcldma";
		reg =	<0 0x10014000 0 0x1000>, /*AP_CLDMA_AO*/
			<0 0x10015000 0 0x1000>, /*MD_CLDMA_AO*/
			<0 0x1021b000 0 0x1000>, /*AP_CLDMA_PDN*/
			<0 0x1021c000 0 0x1000>, /*MD_CLDMA_PDN*/
			<0 0x10209000 0 0x1000>, /*AP_CCIF_BASE*/
			<0 0x1020a000 0 0x1000>; /*MD_CCIF_BASE*/
		interrupts = <GIC_SPI 251 IRQ_TYPE_LEVEL_HIGH>, /*IRQ_CLDMA*/
			     <GIC_SPI 139 IRQ_TYPE_LEVEL_LOW>, /*IRQ_CCIF*/
			     <GIC_SPI 252 IRQ_TYPE_EDGE_FALLING>; /*IRQ_MDWDT*/
		mediatek,md_id = <0>;
		mediatek,cldma_capability = <6>;
		clocks = <&scpsys SCP_SYS_MD1>,
			<&infrasys INFRACFG_AO_CLDMA_BCLK_CK>,
			<&infrasys INFRACFG_AO_CCIF_AP_CG>,
			<&infrasys INFRACFG_AO_CCIF_MD_CG>,
			<&infrasys INFRACFG_AO_CCIF1_AP_CG>,
			<&infrasys INFRACFG_AO_CCIF1_MD_CG>,
			<&infrasys INFRACFG_AO_MD2MD_CCIF_CG0>,
			<&infrasys INFRACFG_AO_MD2MD_CCIF_CG1>,
			<&infrasys INFRACFG_AO_MD2MD_CCIF_CG2>,
			<&infrasys INFRACFG_AO_MD2MD_CCIF_CG3>,
			<&infrasys INFRACFG_AO_MD2MD_CCIF_CG4>,
			<&infrasys INFRACFG_AO_MD2MD_CCIF_CG5>;
		clock-names = "scp-sys-md1-main",
			"infra-cldma-ap",
			"infra-ccif-ap",
			"infra-ccif-md",
			"infra-ap-c2k-ccif-0",
			"infra-ap-c2k-ccif-1",
			"infra-md2md-ccif-0",
			"infra-md2md-ccif-1",
			"infra-md2md-ccif-2",
			"infra-md2md-ccif-3",
			"infra-md2md-ccif-4",
			"infra-md2md-ccif-5";
	};

	aes_top0@10016000 {
		compatible = "mediatek,aes_top0";
		reg = <0 0x10016000 0 0x1000>;
	};

	aes_top1@10017000 {
		compatible = "mediatek,aes_top1";
		reg = <0 0x10017000 0 0x1000>;
	};

	modem_temp_share@10018000 {
		compatible = "mediatek,modem_temp_share";
		reg = <0 0x10018000 0 0x1000>;
	};

	dbgapb_base@1011a000{
		compatible = "mediatek,dbgapb_base";
		reg = <0 0x1011a000 0 0x100>;/* MD debug register */
	};

	mcucfg@10200000 {
		compatible = "mediatek,mcucfg";
		reg = <0 0x10200000 0 0x4000>;
		interrupts = <GIC_SPI 0 IRQ_TYPE_LEVEL_LOW>;
	};

	sys_cirq@10204000 {
		compatible = "mediatek,sys_cirq";
		reg = <0 0x10204000 0 0x1000>;
		interrupts = <GIC_SPI 280 IRQ_TYPE_LEVEL_LOW>;
		mediatek,cirq_num = <209>;
		mediatek,spi_start_offset = <72>;
		mediatek,edge_trig_irqs_for_spm-quantity = <5>;
		mediatek,edge_trig_irqs_for_spm = <162 196 281 284 300>;
	};

	m4u@10205000 {
		cell-index = <0>;
		compatible = "mediatek,m4u";
		reg = <0 0x10205000 0 0x1000>;
		interrupts = <GIC_SPI 147 IRQ_TYPE_LEVEL_LOW>;
		clocks = <&mmsys MMSYS_SMI_COMMON>,
				<&mmsys MMSYS_SMI_LARB0>,
				<&vdecsys VDEC_LARB1>,
				<&camsys CAMSYS_LARB2_CGPDN>,
				<&vencsys VENC_GCON_SET0_LARB>,
				<&vencsys VENC_GCON_SET1_VENC>,
				<&mmsys MMSYS_SMI_LARB4>,
				<&imgsys IMG_LARB5>,
				<&scpsys SCP_SYS_VEN>,
				<&scpsys SCP_SYS_VDE>,
				<&scpsys SCP_SYS_ISP>,
				<&scpsys SCP_SYS_DIS>,
				<&scpsys SCP_SYS_CAM>;
		clock-names = "m4u_smi_common",
				"m4u_smi_larb0",
				"m4u_smi_larb1",
				"m4u_smi_larb2",
				"m4u_smi_larb3",
				"m4u_smi_larb3_2",
				"m4u_smi_larb4",
				"m4u_smi_larb5",
				"m4u_mtcmos_ven",
				"m4u_mtcmos_vde",
				"m4u_mtcmos_isp",
				"m4u_mtcmos_dis",
				"m4u_mtcmos_cam";
	};

	efusec@10206000 {
		compatible = "mediatek,efusec";
		reg = <0 0x10206000 0 0x1000>;
	};

	devapc@10207000 {
		compatible = "mediatek,devapc";
		reg = <0 0x10207000 0 0x1000>;
		interrupts = <GIC_SPI 133 IRQ_TYPE_LEVEL_LOW>;
		clocks = <&infrasys INFRACFG_AO_DEVICE_APC_CG>;
		clock-names = "devapc-main";
	};

	bus_dbg@10208000 {
		compatible = "mediatek,bus_dbg-v2";
		reg = <0 0x10208000 0 0x1000>;
		interrupts = <GIC_SPI 132 IRQ_TYPE_LEVEL_LOW>;
	};

	ap2c2k_ccif@1020b000 {
		compatible = "mediatek,ap2c2k_ccif";
		reg = <0 0x1020b000 0 0x1000>, //CCIF
		<0 0x10211000 0 0x300>, // MD1 PCCIF
		<0 0x10213000 0 0x300>; // MD3 PCCIF
		interrupts = <GIC_SPI 141 IRQ_TYPE_LEVEL_LOW>, // C2K_CCIF
				<GIC_SPI 249 IRQ_TYPE_EDGE_FALLING>; // C2K_WDT
		cell-index = <2>;
		ccif,major = <169>;
		ccif,minor_base = <0>;
		ccif,capability = <2>;	// tx busy stop
		mediatek,md_smem_size = <0x400000>; //md share memory size
		clocks = <&scpsys SCP_SYS_C2K>;
		clock-names = "scp-sys-c2k-main";
	};

	md_ccif1@1020c000 {
		compatible = "mediatek,md_ccif1";
		reg = <0 0x1020c000 0 0x1000>;
	};

	infra_mbist@1020d000 {
		compatible = "mediatek,infra_mbist";
		reg = <0 0x1020d000 0 0x1000>;
	};

	infracfg@1020e000 {
		compatible = "mediatek,infracfg";
		reg = <0 0x1020e000 0 0x1000>;
	};

	trng@1020f000 {
		compatible = "mediatek,trng";
		reg = <0 0x1020f000 0 0x1000>;
		interrupts = <GIC_SPI 140 IRQ_TYPE_LEVEL_LOW>;
	};

	gcpu@10210000 {
		compatible = "mediatek,gcpu";
		reg = <0 0x10210000 0 0x1000>;
		interrupts = <GIC_SPI 150 IRQ_TYPE_LEVEL_LOW>;
	};

	md2md_md1_ccif0@10211000 {
		compatible = "mediatek,md2md_md1_ccif0";
		reg = <0 0x10211000 0 0x1000>;
	};

	gce@10212000 {
		compatible = "mediatek,gce";
		reg = <0 0x10212000 0 0x1000>;
		interrupts = <GIC_SPI 143 IRQ_TYPE_LEVEL_LOW>,
				<GIC_SPI 144 IRQ_TYPE_LEVEL_LOW>;
		g3d_config_base = <0x13000000 0 0xffff0000>;
		mmsys_config_base = <0x14000000 1 0xffff0000>;
		disp_dither_base = <0x14010000 2 0xffff0000>;
		mm_na_base = <0x14020000 3 0xffff0000>;
		imgsys_base = <0x15000000 4 0xffff0000>;
		vdec_gcon_base = <0x16000000 5 0xffff0000>;
		venc_gcon_base = <0x17000000 6 0xffff0000>;
		conn_peri_base = <0x18000000 7 0xffff0000>;
		topckgen_base = <0x10000000 8 0xffff0000>;
		kp_base = <0x10010000 9 0xffff0000>;
		scp_sram_base = <0x10020000 10 0xffff0000>;
		infra_na3_base = <0x10030000 11 0xffff0000>;
		infra_na4_base = <0x10040000 12 0xffff0000>;
		scp_base = <0x10050000 13 0xffff0000>;
		mcucfg_base = <0x10200000 14 0xffff0000>;
		gcpu_base = <0x10210000 15 0xffff0000>;
		usb0_base = <0x11200000 16 0xffff0000>;
		usb_sif_base = <0x11210000 17 0xffff0000>;
		audio_base = <0x11220000 18 0xffff0000>;
		msdc0_base = <0x11230000 19 0xffff0000>;
		msdc1_base = <0x11240000 20 0xffff0000>;
		msdc2_base = <0x11250000 21 0xffff0000>;
		msdc3_base = <0x11260000 22 0xffff0000>;
		ap_dma_base = <0x11000000 23 0xffff0000>;
		smi_larb1_base = <0x16010000 24 0xffff0000>;
		vdec_base = <0x16020000 25 0xffff0000>;
		imgsys_config = <0x15020000 99 0xffff0000>;
		disp_rdma0_sof = <0>;
		disp_rdma1_sof = <1>;
		mdp_rdma0_sof = <3>;
		mdp_rdma1_sof = <4>;
		mdp_rsz1_sof = <6>;
		mdp_rsz2_sof = <7>;
		mdp_tdshp_sof = <8>;
		mdp_color_sof = <9>;
		mdp_wrot0_sof = <11>;
		mdp_wrot1_sof = <12>;
		disp_ovl0_sof = <13>;
		disp_ovl1_sof = <14>;
		disp_2l_ovl0_sof = <15>;
		disp_2l_ovl1_sof = <16>;
		disp_wdma0_sof = <17>;
		disp_wdma1_sof = <18>;
		disp_color_sof = <19>;
		disp_ccorr_sof = <21>;
		disp_aal_sof = <23>;
		disp_gamma_sof = <25>;
		disp_dither_sof = <28>;
		disp_ufoe_sof = <30>;
		disp_pwm0_sof = <32>;
		disp_dsi0_sof = <33>;
		disp_dsi1_sof = <34>;
		disp_rdma0_frame_done = <35>;
		disp_rdma1_frame_done = <36>;
		mdp_rdma0_frame_done = <38>;
		mdp_rdma1_frame_done = <39>;
		mdp_rsz1_frame_done = <41>;
		mdp_rsz2_frame_done = <42>;
		mdp_tdshp_frame_done = <43>;
		mdp_color_frame_done = <44>;
		mdp_wrot0_write_frame_done = <46>;
		mdp_wrot0_read_frame_done = <47>;
		mdp_wrot1_write_frame_done = <48>;
		mdp_wrot1_read_frame_done = <49>;
		disp_ovl0_frame_done = <50>;
		disp_ovl1_frame_done = <51>;
		disp_2l_ovl0_frame_done = <52>;
		disp_2l_ovl1_frame_done = <53>;
		disp_wdma0_frame_done = <54>;
		disp_wdma1_frame_done = <55>;
		disp_color_frame_done = <56>;
		disp_ccorr_frame_done = <58>;
		disp_aal_frame_done = <60>;
		disp_gamma_frame_done = <62>;
		disp_dither_frame_done = <65>;
		disp_ufoe_frame_done = <67>;
		disp_dsi0_frame_done = <69>;
		disp_dsi1_frame_done = <70>;
		disp_dpi0_frame_done = <71>;
		stream_done_0 = <130>;
		stream_done_1 = <131>;
		stream_done_2 = <132>;
		stream_done_3 = <133>;
		stream_done_4 = <134>;
		stream_done_5 = <135>;
		stream_done_6 = <136>;
		stream_done_7 = <137>;
		stream_done_8 = <138>;
		stream_done_9 = <139>;
		stream_done_10 = <140>;
		stream_done_11 = <141>;
		stream_done_12 = <142>;
		stream_done_13 = <143>;
		stream_done_14 = <144>;
		stream_done_15 = <145>;
		buf_underrun_event_0 = <146>;
		buf_underrun_event_1 = <147>;
		dsi0_te_event = <151>;
		dsi0_to_gce_mmck0 = <152>;
		dsi0_to_gce_mmck1 = <153>;
		dsi0_to_gce_mmck2 = <154>;
		dsi0_to_gce_mmck3 = <155>;
		dsi0_to_gce_mmck4 = <156>;
		dsi1_te_event = <157>;
		dsi1_to_gce_mmck0 = <158>;
		dsi1_to_gce_mmck1 = <159>;
		dsi1_to_gce_mmck2 = <160>;
		dsi1_to_gce_mmck3 = <161>;
		dsi1_to_gce_mmck4 = <162>;
		disp_wdma0_rst_done = <163>;
		disp_wdma1_rst_done = <164>;
		mdp_wrot1_rst_done = <165>;
		mdp_wrot0_rst_done = <166>;
		mdp_rdma1_rst_done = <168>;
		mdp_rdma0_rst_done = <169>;
		disp_mutex_all_module_upd0 = <171>;
		disp_mutex_all_module_upd1 = <172>;
		disp_mutex_all_module_upd2 = <173>;
		disp_mutex_all_module_upd3 = <174>;
		disp_mutex_all_module_upd4 = <175>;
		disp_mutex_all_module_upd5 = <176>;
		disp_mutex_all_module_upd6 = <177>;
		disp_mutex_all_module_upd7 = <178>;
		disp_mutex_all_module_upd8 = <179>;
		disp_mutex_all_module_upd9 = <180>;
		disp_mutex_all_module_upd10 = <181>;
		disp_mutex_all_module_upd11 = <182>;
		disp_mutex_all_module_upd12 = <183>;
		disp_mutex_all_module_upd13 = <184>;
		disp_mutex_all_module_upd14 = <185>;
		disp_mutex_all_module_upd15 = <186>;
		disp_mutex_reg_upd_for_module0 = <187>;
		disp_mutex_reg_upd_for_module1 = <188>;
		disp_mutex_reg_upd_for_module2 = <189>;
		disp_mutex_reg_upd_for_module3 = <190>;
		disp_mutex_reg_upd_for_module4 = <191>;
		disp_mutex_reg_upd_for_module5 = <192>;
		disp_mutex_reg_upd_for_module6 = <193>;
		disp_mutex_reg_upd_for_module7 = <194>;
		disp_mutex_reg_upd_for_module8 = <195>;
		disp_mutex_reg_upd_for_module9 = <196>;
		disp_mutex_reg_upd_for_module10 = <197>;
		disp_mutex_reg_upd_for_module11 = <198>;
		disp_mutex_reg_upd_for_module12 = <199>;
		disp_mutex_reg_upd_for_module13 = <200>;
		disp_mutex_reg_upd_for_module14 = <201>;
		disp_mutex_reg_upd_for_module15 = <202>;
		disp_mutex_reg_upd_for_module16 = <203>;
		disp_mutex_reg_upd_for_module17 = <204>;
		disp_mutex_reg_upd_for_module18 = <205>;
		disp_mutex_reg_upd_for_module19 = <206>;
		disp_mutex_reg_upd_for_module20 = <207>;
		disp_mutex_reg_upd_for_module21 = <208>;
		disp_mutex_reg_upd_for_module22 = <209>;
		disp_mutex_reg_upd_for_module23 = <210>;
		disp_mutex_reg_upd_for_module24 = <211>;
		disp_mutex_reg_upd_for_module25 = <212>;
		disp_mutex_reg_upd_for_module26 = <213>;
		disp_mutex_reg_upd_for_module27 = <214>;
		disp_mutex_reg_upd_for_module28 = <215>;
		disp_mutex_reg_upd_for_module29 = <216>;
		disp_mutex_reg_upd_for_module30 = <217>;
		disp_mutex_reg_upd_for_module31 = <218>;
		disp_mutex_reg_upd_for_module32 = <219>;
		disp_mutex_reg_upd_for_module33 = <220>;
		disp_mutex_reg_upd_for_module34 = <221>;
		dip_cq_thread0_frame_done = <257>;
		dip_cq_thread1_frame_done = <258>;
		dip_cq_thread2_frame_done = <259>;
		dip_cq_thread3_frame_done = <260>;
		dip_cq_thread4_frame_done = <261>;
		dip_cq_thread5_frame_done = <262>;
		dip_cq_thread6_frame_done = <263>;
		dip_cq_thread7_frame_done = <264>;
		dip_cq_thread8_frame_done = <265>;
		dip_cq_thread9_frame_done = <266>;
		dip_cq_thread10_frame_done = <267>;
		dip_cq_thread11_frame_done = <268>;
		dip_cq_thread12_frame_done = <269>;
		dip_cq_thread13_frame_done = <270>;
		dip_cq_thread14_frame_done = <271>;
		dve_frame_done = <272>;
		wmf_frame_done = <273>;
		gepf_frame_done = <274>;
		gepf_temp_frame_done = <275>;
		gepf_bypass_frame_done = <276>;
		rsc_frame_done = <277>;
		venc_done = <289>;
		jpgdec_done = <290>;
		jpgenc_done = <291>;
		venc_mb_done = <292>;
		venc_128byte_cnt_done = <293>;
		isp_frame_done_a = <321>;
		isp_frame_done_b = <322>;
		camsv_0_pass1_done = <323>;
		camsv_1_pass1_done = <324>;
		camsv_2_pass1_done = <325>;
		tsf_done = <326>;
		seninf_0_fifo_full = <327>;
		seninf_1_fifo_full = <328>;
		seninf_2_fifo_full = <329>;
		seninf_3_fifo_full = <330>;
		seninf_4_fifo_full = <331>;
		seninf_5_fifo_full = <332>;
		seninf_6_fifo_full = <333>;
		seninf_7_fifo_full = <334>;
		max_prefetch_cnt = <4>;
		prefetch_size = <160 32 32 32>;
		sram_share_cnt = <2>;
		sram_share_engine = <11 12>;
		sram_share_event = <460 461>;
		clocks = <&infrasys INFRACFG_AO_GCE_CG>;
		clock-names = "GCE";
		mmsys_dummy_reg_offset = <0x8ac>;
	};

	cqdma@10212c00 {
		compatible = "mediatek,mt-cqdma-v1";
		reg = <0 0x10212c00 0 0x100>,
			<0 0x10212d00 0 0x100>;
		interrupts = <GIC_SPI 113 IRQ_TYPE_LEVEL_LOW>,
			<GIC_SPI 114 IRQ_TYPE_LEVEL_LOW>;
		nr_channel = <2>;
		clocks = <&infrasys INFRACFG_AO_GCE_CG>;
		clock-names = "cqdma";
	};

	md2md_md2_ccif0@10213000 {
		compatible = "mediatek,md2md_md2_ccif0";
		reg = <0 0x10213000 0 0x1000>;
	};

	sramrom@10214000 {
		compatible = "mediatek,sramrom";
		reg = <0 0x10214000 0 0x1000>;
	};

	mipi_tx0@10215000 {
		compatible = "mediatek,mipi_tx0";
		reg = <0 0x10215000 0 0x1000>;
	};

	mipi_tx1@10216000 {
		compatible = "mediatek,mipi_tx1";
		reg = <0 0x10216000 0 0x1000>;
	};

	mipi_rx_ana_csi0@10217000 {
		compatible = "mediatek,mipi_rx_ana_csi0";
		reg = <0 0x10217000 0 0x1000>;
	};

	mipi_rx_ana_csi1@10218000 {
		compatible = "mediatek,mipi_rx_ana_csi1";
		reg = <0 0x10218000 0 0x1000>;
	};

	emi@10219000 {
		compatible = "mediatek,emi";
		reg = <0 0x10219000 0 0x1000>;
		interrupts = <GIC_SPI 135 IRQ_TYPE_LEVEL_HIGH>;
	};

	gcpu_rsa@1021a000 {
		compatible = "mediatek,gcpu_rsa";
		reg = <0 0x1021a000 0 0x1000>;
	};

	infra_md@1021d000 {
		compatible = "mediatek,infra_md";
		reg = <0 0x1021d000 0 0x1000>;
	};

	bpi_bsi_slv0@1021e000 {
		compatible = "mediatek,bpi_bsi_slv0";
		reg = <0 0x1021e000 0 0x1000>;
	};

	bpi_bsi_slv1@1021f000 {
		compatible = "mediatek,bpi_bsi_slv1";
		reg = <0 0x1021f000 0 0x6000>;
	};

	bpi_bsi_slv2@10225000 {
		compatible = "mediatek,bpi_bsi_slv2";
		reg = <0 0x10225000 0 0x1000>;
	};

	emi_mpu@10226000 {
		compatible = "mediatek,emi_mpu";
		reg = <0 0x10226000 0 0x1000>;
		interrupts = <GIC_SPI 117 IRQ_TYPE_LEVEL_HIGH>;
	};

	dvfsp@10227000 {
		compatible = "mediatek,mt6757-dvfsp";
		reg = <0 0x10227000 0 0x1000>,
		      <0 0x0011c000 0 0xf80>;
		interrupts = <GIC_SPI 152 IRQ_TYPE_LEVEL_LOW>;
		clocks = <&infrasys INFRACFG_AO_I2C3_CG>;
		clock-names = "i2c";
	};

	dramc_ch0_top0@10228000 {
		compatible = "mediatek,dramc_ch0_top0";
		reg = <0 0x10228000 0 0x2000>;
	};

	dramc_ch0_top1@1022a000 {
		compatible = "mediatek,dramc_ch0_top1";
		reg = <0 0x1022a000 0 0x2000>;
	};

	dramc_ch0_top2@1022c000 {
		compatible = "mediatek,dramc_ch0_top2";
		reg = <0 0x1022c000 0 0x1000>;
	};

	dramc_ch0_top3@1022d000 {
		compatible = "mediatek,dramc_ch0_top3";
		reg = <0 0x1022d000 0 0x1000>;
	};

	dramc_ch0_rsv@1022e000 {
		compatible = "mediatek,dramc_ch0_rsv";
		reg = <0 0x1022e000 0 0x2000>;
	};

	dramc_ch1_top0@10230000 {
		compatible = "mediatek,dramc_ch1_top0";
		reg = <0 0x10230000 0 0x2000>;
	};

	dramc_ch1_top1@10232000 {
		compatible = "mediatek,dramc_ch1_top1";
		reg = <0 0x10232000 0 0x2000>;
	};

	dramc_ch1_top2@10234000 {
		compatible = "mediatek,dramc_ch1_top2";
		reg = <0 0x10234000 0 0x1000>;
	};

	dramc_ch1_top3@10235000 {
		compatible = "mediatek,dramc_ch1_top3";
		reg = <0 0x10235000 0 0x1000>;
	};

	dramc_ch1_rsv@10236000 {
		compatible = "mediatek,dramc_ch1_rsv";
		reg = <0 0x10236000 0 0x2000>;
	};

	fmem_smi_dvfsp@10238000 {
		compatible = "mediatek,fmem_smi_dvfsp";
		reg = <0 0x10238000 0 0x1000>;
	};

	cci400@10390000 {
		compatible = "mediatek,cci400";
		reg = <0 0x10390000 0 0x10000>;
	};

	ap_dma@11000000 {
		compatible = "mediatek,ap_dma";
		reg = <0 0x11000000 0 0x1000>;
		interrupts = <GIC_SPI 82 IRQ_TYPE_LEVEL_LOW>;
	};

	auxadc: auxadc@11001000 {
		compatible = "mediatek,mt6757-auxadc";
		reg = <0 0x11001000 0 0x1000>;
		interrupts = <GIC_SPI 74 IRQ_TYPE_EDGE_FALLING>;
		clocks = <&infrasys INFRACFG_AO_AUXADC_CG>;
		clock-names = "auxadc-main";
	};

	apuart0: apuart0@11002000 {
		cell-index = <0>;
			compatible = "mediatek,mt6755-uart";
			reg = <0 0x11002000 0 0x1000>, /* UART base */
				  <0 0x11000580 0 0x1000>, /* DMA Tx base */
				  <0 0x11000600 0 0x80>; /* DMA Rx base */
			interrupts = <GIC_SPI 91 IRQ_TYPE_LEVEL_LOW>, /* UART IRQ */
						 <GIC_SPI 107 IRQ_TYPE_LEVEL_LOW>, /* DMA Tx IRQ */
						 <GIC_SPI 108 IRQ_TYPE_LEVEL_LOW>; /* DMA Rx IRQ */

			clock-frequency = <26000000>;
			clock-div = <1>;
			clocks = <&infrasys INFRACFG_AO_UART0_CG>, <&infrasys INFRACFG_AO_AP_DMA_CG>;
			clock-names = "uart0-main", "uart-apdma";
	};

	apuart1: apuart1@11003000 {
		cell-index = <1>;
			compatible = "mediatek,mt6755-uart";
			reg = <0 0x11003000 0 0x1000>, /* UART base */
				  <0 0x11000680 0 0x80>, /* DMA Tx base */
				  <0 0x11000700 0 0x80>; /* DMA Rx base */
			interrupts = <GIC_SPI 92 IRQ_TYPE_LEVEL_LOW>, /* UART IRQ */
						 <GIC_SPI 109 IRQ_TYPE_LEVEL_LOW>, /* DMA Tx IRQ */
						 <GIC_SPI 110 IRQ_TYPE_LEVEL_LOW>; /* DMA Rx IRQ */

			clock-frequency = <26000000>;
			clock-div = <1>;
			clocks = <&infrasys INFRACFG_AO_UART1_CG>;
			clock-names = "uart1-main";
	};

	/*apuart2: apuart2@11004000 {*/
	/*	compatible = "mediatek,ap_uart2";*/
	/*	reg = <0 0x11004000 0 0x1000>;*/
	/*	interrupts = <GIC_SPI 93 IRQ_TYPE_LEVEL_LOW>;*/
	/*};*/

	pwm@11006000 {
		compatible = "mediatek,pwm";
		reg = <0 0x11006000 0 0x1000>;
		interrupts = <GIC_SPI 77 IRQ_TYPE_LEVEL_LOW>;
		clocks = <&infrasys INFRACFG_AO_PWM1_CG>,
			<&infrasys INFRACFG_AO_PWM2_CG>,
			<&infrasys INFRACFG_AO_PWM3_CG>,
			<&infrasys INFRACFG_AO_PWM4_CG>,
			<&infrasys INFRACFG_AO_PWM_HCLK_CG>,
			<&infrasys INFRACFG_AO_PWM_CG>;
		clock-names = "PWM1-main",
				"PWM2-main",
				"PWM3-main",
				"PWM4-main",
				"PWM-HCLK-main",
				"PWM-main";
	};

	i2c0: i2c@11007000 {
		compatible = "mediatek,mt6757-i2c";
		id = <0>;
		reg = <0 0x11007000 0 0x1000>,
			<0 0x11000100 0 0x80>;
		interrupts = <GIC_SPI 84 IRQ_TYPE_LEVEL_LOW>;
		clocks = <&infrasys INFRACFG_AO_I2C0_CG>, <&infrasys INFRACFG_AO_AP_DMA_CG>;
		clock-names = "main", "dma";
		clock-div = <5>;
	};

	i2c6: i2c@11008000 {
		compatible = "mediatek,mt6757-i2c";
		id = <6>;
		reg = <0 0x11008000 0 0x1000>,
			<0 0x11000180 0 0x80>;
		interrupts = <GIC_SPI 85 IRQ_TYPE_LEVEL_LOW>;
		clocks = <&infrasys INFRACFG_AO_I2C1_CG>, <&infrasys INFRACFG_AO_AP_DMA_CG>,
					<&infrasys INFRACFG_AO_I2C1_ARBITER_CG>;
		clock-names = "main", "dma", "arb";
		clock-div = <5>;
		mediatek,buffermode_used;
	};

	i2c7: i2c@11009000 {
		compatible = "mediatek,mt6757-i2c";
		id = <7>;
		reg = <0 0x11009000 0 0x1000>,
			<0 0x11000200 0 0x80>;
		interrupts = <GIC_SPI 86 IRQ_TYPE_LEVEL_LOW>;
		clocks = <&infrasys INFRACFG_AO_I2C2_CG>, <&infrasys INFRACFG_AO_AP_DMA_CG>,
					<&infrasys INFRACFG_AO_I2C2_ARBITER_CG>;
		clock-names = "main", "dma", "arb";
		clock-div = <5>;
		mediatek,buffermode_used;
	};

	spi0: spi@1100a000 {
		compatible = "mediatek,mt6757-spi";
		cell-index = <0>;
		spi-padmacro = <0>;
		reg = <0 0x1100a000 0 0x1000>;
		interrupts = <GIC_SPI 118 IRQ_TYPE_LEVEL_LOW>;
		clocks = <&infrasys INFRACFG_AO_SPI0_CG>;
		clock-names = "main";
		clock-frequency = <109000000>;
		clock-div = <1>;
	};

	therm_ctrl@1100b000 {
		compatible = "mediatek,mt6757-therm_ctrl";
		reg = <0 0x1100b000 0 0x1000>;
		interrupts = <GIC_SPI 78 IRQ_TYPE_LEVEL_LOW>;
		clocks = <&infrasys INFRACFG_AO_THERM_CG>, <&infrasys INFRACFG_AO_AUXADC_CG>;
		clock-names = "therm-main", "therm-auxadc";
	};

	eem_fsm@1100b000 {
		compatible = "mediatek,mt6757-eem_fsm";
		reg = <0 0x1100b000 0 0x1000>;
		interrupts = <GIC_SPI 125 IRQ_TYPE_LEVEL_LOW>;
		clocks = <&mfgsys MFGCFG_BG3D>, <&scpsys SCP_SYS_MFG>, <&infrasys INFRACFG_AO_THERM_CG>;
		clock-names = "mfg-main", "mtcmos-mfg", "therm-eem";
	};

	btif@1100c000 {
		compatible = "mediatek,btif";
		#address-cells = <2>;
		#size-cells = <2>;
		reg = <0 0x1100c000 0 0x1000>,	/*btif base*/
		    <0 0x11000980 0 0x80>,	/*btif tx dma base*/
		    <0 0x11000a00 0 0x80>;	/*btif rx dma base*/
		interrupts = <GIC_SPI 112 IRQ_TYPE_LEVEL_LOW>,	/*btif irq*/
			   <GIC_SPI 96 IRQ_TYPE_LEVEL_LOW>,	/*btif tx dma irq*/
			   <GIC_SPI 124 IRQ_TYPE_LEVEL_LOW>;	/*btif rx dma irq*/
		clocks = <&infrasys INFRACFG_AO_BTIF_CG>,	/*btif clock*/
		       <&infrasys INFRACFG_AO_AP_DMA_CG>;	/*ap dma clock*/
		clock-names = "btifc","apdmac";
	};

	irtx@1100d000 {
		compatible = "mediatek,irtx";
		reg = <0 0x1100d000 0 0x1000>;
		interrupts = <GIC_SPI 127 IRQ_TYPE_LEVEL_LOW>;
	};

	disp_pwm@1100e000 {
		compatible = "mediatek,disp_pwm";
		reg = <0 0x1100e000 0 0x1000>;
	};

	i2c3: i2c@1100f000 {
		compatible = "mediatek,mt6757-i2c";
		id = <3>;
		reg = <0 0x11011000 0 0x1000>,
			<0 0x11000300 0 0x80>;
		interrupts = <GIC_SPI 88 IRQ_TYPE_LEVEL_LOW>;
		clocks = <&infrasys INFRACFG_AO_I2C4_CG>, <&infrasys INFRACFG_AO_AP_DMA_CG>;
		clock-names = "main", "dma";
		clock-div = <5>;
	};

	spi1: spi@11010000 {
		compatible = "mediatek,mt6757-spi";
		cell-index = <1>;
		spi-padmacro = <0>;
		reg = <0 0x11010000 0 0x1000>;
		interrupts = <GIC_SPI 122 IRQ_TYPE_LEVEL_LOW>;
		clocks = <&infrasys INFRACFG_AO_SPI1_CG>;
		clock-names = "main";
		clock-frequency = <109000000>;
		clock-div = <1>;
	};

	i2c5: i2c@11011000 {
		compatible = "mediatek,mt6757-i2c";
		id = <5>;
		reg = <0 0x1100f000 0 0x1000>,
			<0 0x11000280 0 0x80>;
		interrupts = <GIC_SPI 87 IRQ_TYPE_LEVEL_LOW>;
		clocks = <&infrasys INFRACFG_AO_I2C3_CG>, <&infrasys INFRACFG_AO_AP_DMA_CG>;
		clock-names = "main", "dma";
		clock-div = <5>;
		mediatek,appm_used;
	};

	spi2: spi@11012000 {
		compatible = "mediatek,mt6757-spi";
		cell-index = <2>;
		spi-padmacro = <0>;
		reg = <0 0x11012000 0 0x1000>;
		interrupts = <GIC_SPI 128 IRQ_TYPE_LEVEL_LOW>;
		clocks = <&infrasys INFRACFG_AO_SPI2_CG>;
		clock-names = "main";
		clock-frequency = <109000000>;
		clock-div = <1>;
	};

	spi3: spi@11013000 {
		compatible = "mediatek,mt6757-spi";
		cell-index = <3>;
		spi-padmacro = <0>;
		reg = <0 0x11013000 0 0x1000>;
		interrupts = <GIC_SPI 129 IRQ_TYPE_LEVEL_LOW>;
		clocks = <&infrasys INFRACFG_AO_SPI3_CG>;
		clock-names = "main";
		clock-frequency = <109000000>;
		clock-div = <1>;
	};

	i2c1: i2c@11014000 {
		compatible = "mediatek,mt6757-i2c";
		id = <1>;
		reg = <0 0x11014000 0 0x1000>,
			<0 0x11000380 0 0x80>;
		interrupts = <GIC_SPI 270 IRQ_TYPE_LEVEL_LOW>;
		clocks = <&infrasys INFRACFG_AO_I2C1_IMM_CG>, <&infrasys INFRACFG_AO_AP_DMA_CG>,
					<&infrasys INFRACFG_AO_I2C1_ARBITER_CG>;
		clock-names = "main", "dma", "arb";
		clock-div = <5>;
	};

	i2c2: i2c@11015000 {
		compatible = "mediatek,mt6757-i2c";
		id = <2>;
		reg = <0 0x11015000 0 0x1000>,
			<0 0x11000400 0 0x80>;
		interrupts = <GIC_SPI 271 IRQ_TYPE_LEVEL_LOW>;
		clocks = <&infrasys INFRACFG_AO_I2C2_IMM_CG>, <&infrasys INFRACFG_AO_AP_DMA_CG>,
					<&infrasys INFRACFG_AO_I2C2_ARBITER_CG>;
		clock-names = "main", "dma", "arb";
		clock-div = <5>;
	};


	i2c8: i2c@11016000 {
		compatible = "mediatek,mt6757-i2c";
		id = <8>;
		reg = <0 0x11016000 0 0x1000>,
			<0 0x11000480 0 0x80>;
		interrupts = <GIC_SPI 269 IRQ_TYPE_LEVEL_LOW>;
		clocks = <&infrasys INFRACFG_AO_I2C5_CG>, <&infrasys INFRACFG_AO_AP_DMA_CG>,
					<&infrasys INFRACFG_AO_I2C5_ARBITER_CG>;
		clock-names = "main", "dma", "arb";
		clock-div = <5>;
		mediatek,buffermode_used;
	};

	i2c4: i2c@11017000 {
		compatible = "mediatek,mt6757-i2c";
		id = <4>;
		reg = <0 0x11017000 0 0x1000>,
			<0 0x11000500 0 0x80>;
		interrupts = <GIC_SPI 272 IRQ_TYPE_LEVEL_LOW>;
		clocks = <&infrasys INFRACFG_AO_I2C5_IMM_CG>, <&infrasys INFRACFG_AO_AP_DMA_CG>,
					<&infrasys INFRACFG_AO_I2C5_ARBITER_CG>;
		clock-names = "main", "dma", "arb";
		clock-div = <5>;
	};

	spi4: spi@11018000 {
		compatible = "mediatek,mt6757-spi";
		cell-index = <4>;
		spi-padmacro = <0>;
		reg = <0 0x11018000 0 0x1000>;
		interrupts = <GIC_SPI 273 IRQ_TYPE_LEVEL_LOW>;
		clocks = <&infrasys INFRACFG_AO_SPI4_CG>;
		clock-names = "main";
		clock-frequency = <109000000>;
		clock-div = <1>;
	};

	spi5: spi@11019000 {
		compatible = "mediatek,mt6757-spi";
		cell-index = <5>;
		spi-padmacro = <0>;
		reg = <0 0x11019000 0 0x1000>;
		interrupts = <GIC_SPI 274 IRQ_TYPE_LEVEL_LOW>;
		clocks = <&infrasys INFRACFG_AO_SPI5_CG>;
		clock-names = "main";
		clock-frequency = <109000000>;
		clock-div = <1>;
	};

	usb0@11200000 {
		compatible = "mediatek,usb0";
		cell-index = <0>;
		reg = <0 0x11200000 0 0x10000>,
		<0 0x11210000 0 0x10000>;
		interrupts = <GIC_SPI 73 IRQ_TYPE_LEVEL_LOW>;
		mode = <2>;
		multipoint = <1>;
		dyn_fifo = <1>;
		soft_con = <1>;
		dma = <1>;
		num_eps = <16>;
		dma_channels = <8>;
		drvvbus_gpio = <83 2>;
	};

	usb1@11210000 {
		compatible = "mediatek,usb1";
		reg = <0 0x11210000 0 0x10000>;
		interrupts = <GIC_SPI 73 IRQ_TYPE_LEVEL_LOW>;
	};

	audiosys: audio@11220000 {
		compatible = "mediatek,audio";
		reg = <0 0x11220000 0 0x1000>;
		interrupts = <GIC_SPI 142 IRQ_TYPE_LEVEL_LOW>;
		#clock-cells = <1>;
	};

	audgpio: mt_soc_dl1_pcm@11220000 {
		compatible = "mediatek,mt_soc_pcm_dl1";
		reg = <0 0x11220000 0 0x1000>;
		interrupts = <GIC_SPI 142 IRQ_TYPE_LEVEL_LOW>;
		clocks = <&audiosys AUDIO_AFE>,
			<&audiosys AUDIO_I2S>,
			<&audiosys AUDIO_DAC>,
			<&audiosys AUDIO_DAC_PREDIS>,
			<&audiosys AUDIO_ADC>,
			<&audiosys AUDIO_22M>,
			<&audiosys AUDIO_24M>,
			<&audiosys AUDIO_APLL_TUNER>,
			<&audiosys AUDIO_APLL2_TUNER>,
			<&audiosys AUDIO_TML>,
			<&scpsys SCP_SYS_AUDIO>,
			<&infrasys INFRACFG_AO_AUDIO_CG>,
			<&infrasys INFRACFG_AO_AUDIO_26M_BCLK_CK>,
			<&topckgen TOP_MUX_AUD_1>,
			<&topckgen TOP_MUX_AUD_2>,
			<&topckgen TOP_APLL1_CK>,
			<&topckgen TOP_APLL2_CK>,
			<&topckgen TOP_MUX_AUD_INTBUS>,
			<&topckgen TOP_SYSPLL1_D4>,
			<&apmixedsys APMIXED_APLL1>,
			<&apmixedsys APMIXED_APLL2>,
			<&clk26m>;
		clock-names = "aud_afe_clk",
			"aud_i2s_clk",
			"aud_dac_clk",
			"aud_dac_predis_clk",
			"aud_adc_clk",
			"aud_apll22m_clk",
			"aud_apll24m_clk",
			"aud_apll1_tuner_clk",
			"aud_apll2_tuner_clk",
			"aud_tml_clk",
			"scp_sys_aud",
			"aud_infra_clk",
			"aud_peri_26m_clk",
			"aud_mux1_clk",
			"aud_mux2_clk",
			"top_ad_apll1_clk",
			"top_ad_apll2_clk",
			"top_mux_audio_int",
			"top_sys_pll1_d4",
			"apmixed_apll1_clk",
			"apmixed_apll2_clk",
			"top_clk26m_clk";
	};

	audio_sram@11221000 {
		compatible = "mediatek,audio_sram";
		reg = <0 0x11221000 0 0xb400>;
	};

	usb0:usb3@11270000 {
		compatible = "mediatek,usb3";
		reg = <0 0x11270000 0 0x10000>, <0 0x11280700 0 0x100>, <0 0x11290000 0 0x10000>;
		reg-names = "ssusb_base", "ssusb_ippc", "ssusb_sif2";
		interrupts = <GIC_SPI 72 IRQ_TYPE_LEVEL_LOW>,
				<GIC_SPI 73 IRQ_TYPE_LEVEL_LOW>;
		interrupt-names = "musb-hdrc", "xhci";
	};

	xhci0:usb3_xhci@11270000 {
		compatible = "mediatek,mt67xx-xhci";
		reg = <0 0x11270000 0 0x1000>, <0 0x11280700 0 0x100>;
		reg-names = "ssusb_base", "ssusb_sif";
		interrupts = <GIC_SPI 123 IRQ_TYPE_LEVEL_LOW>;
		interrupt-names = "xhci";
	};

	mfgsys: g3d_config@13000000 {
		compatible = "mediatek,g3d_config";
		reg = <0 0x13000000 0 0x1000>;
		#clock-cells = <1>;
	};

	vad_gpu@13001000 {
		compatible = "mediatek,vad_gpu";
		reg = <0 0x13001000 0 0x1000>;
	};

	vad_sc0@13002000 {
		compatible = "mediatek,vad_sc0";
		reg = <0 0x13002000 0 0x1000>;
	};

	vad_sc1@13003000 {
		compatible = "mediatek,vad_sc1";
		reg = <0 0x13003000 0 0x1000>;
	};

	dfp@13020000 {
		compatible = "mediatek,dfp";
		reg = <0 0x13020000 0 0x1000>;
	};

	mali@13040000 {
		compatible = "arm,malit860", "arm,mali-t86x", "arm,malit8xx", "arm,mali-midgard";
			reg = <0 0x13040000 0 0x4000>;
			interrupts = <GIC_SPI 247 IRQ_TYPE_LEVEL_LOW>,
					<GIC_SPI 246 IRQ_TYPE_LEVEL_LOW>,
					<GIC_SPI 245 IRQ_TYPE_LEVEL_LOW>;
			interrupt-names = "JOB", "MMU", "GPU";
			clock-frequency = <700000000>;
			clocks = <&mfgsys MFGCFG_BG3D>, <&topckgen TOP_MUX_F52M_MFG>, <&scpsys SCP_SYS_MFG_ASYNC>,
				 <&scpsys SCP_SYS_MFG>, <&scpsys SCP_SYS_MFG_CORE0>,
				 <&scpsys SCP_SYS_MFG_CORE1>;
			clock-names = "mfg-main", "mfg-f52m-sel", "mtcmos-mfg-async",
				 "mtcmos-mfg", "mtcmos-mfg-core0",
				 "mtcmos-mfg-core1";
	};

	mmsys: mmsys_config@14000000 {
		compatible = "mediatek,mmsys_config";
		reg = <0 0x14000000 0 0x1000>;
		interrupts = <GIC_SPI 213 IRQ_TYPE_LEVEL_LOW>;
		#clock-cells = <1>;
		clocks = <&mmsys MMSYS_CAM_MDP>;
		clock-names = "CAM_MDP";
	};

	dispsys: dispsys@14000000 {
		compatible = "mediatek,dispsys";
		reg = <0 0x14000000 0 0x1000>,  /*disp_sys		*/
			<0 0x1400b000 0 0x1000>,  /*disp_ovl0	*/
			<0 0x1400c000 0 0x1000>,  /*disp_ovl1	*/
			<0 0x1400d000 0 0x1000>,  /*disp_ovl0_2l	*/
			<0 0x1400e000 0 0x1000>,  /*disp_ovl1_2l	*/
			<0 0x1400f000 0 0x1000>,  /*disp_rdma0	*/
			<0 0x14010000 0 0x1000>,  /*disp_rdma1	*/
			<0 0x14011000 0 0x1000>,  /*disp_rdma2	*/
			<0 0x14012000 0 0x1000>,  /*disp_wdma0	*/
			<0 0x14013000 0 0x1000>,  /*disp_wdma1	*/
			<0 0x14014000 0 0x1000>,  /*disp_color0	*/
			<0 0x14015000 0 0x1000>,  /*disp_color1	*/
			<0 0x14016000 0 0x1000>,  /*disp_ccorr0	*/
			<0 0x14017000 0 0x1000>,  /*disp_ccorr1	*/
			<0 0x14018000 0 0x1000>,  /*disp_aal0	*/
			<0 0x14019000 0 0x1000>,  /*disp_aal1	*/
			<0 0x1401a000 0 0x1000>,  /*disp_gamma0	*/
			<0 0x1401b000 0 0x1000>,  /*disp_gamma1	*/
			<0 0x1401c000 0 0x1000>,  /*disp_od		*/
			<0 0x1401d000 0 0x1000>,  /*disp_dither0	*/
			<0 0x1401e000 0 0x1000>,  /*disp_dither1	*/
			<0 0x1401f000 0 0x1000>,  /*disp_dsi_ufoe	*/
			<0 0x14020000 0 0x1000>,  /*disp_dsi_dsc	*/
			<0 0x14021000 0 0x1000>,  /*disp_split	*/
			<0 0x14022000 0 0x1000>,  /*disp_dsi0	*/
			<0 0x14023000 0 0x1000>,  /*disp_dsi1	*/
			<0 0x14024000 0 0x1000>,  /*disp_dpi0	*/
			<0 0x1100e000 0 0x1000>,  /*disp_pwm0	*/
			<0 0x14025000 0 0x1000>,  /*disp_mm_mutex	*/
			<0 0x14026000 0 0x1000>,  /*disp_smi_larb0	*/
			<0 0x14027000 0 0x1000>,  /*disp_smi_larb4	*/
			<0 0x14028000 0 0x1000>,  /*disp_smi_commom	*/
			<0 0x10215000 0 0x10000>,  /*mipitx0	*/
			<0 0x10216000 0 0x10000>,  /*mipitx1	*/
			<0 0x1100e000 0 0x10000>; /*disp_pwm1	*/

		interrupts = <GIC_SPI 0 IRQ_TYPE_LEVEL_LOW>, /*disp_sys */
			<GIC_SPI 188 IRQ_TYPE_LEVEL_LOW>, /*disp_ovl0 */
			<GIC_SPI 189 IRQ_TYPE_LEVEL_LOW>, /*disp_ovl1 */
			<GIC_SPI 190 IRQ_TYPE_LEVEL_LOW>, /*disp_ovl0_2l */
			<GIC_SPI 191 IRQ_TYPE_LEVEL_LOW>, /*disp_ovl1_2l */
			<GIC_SPI 192 IRQ_TYPE_LEVEL_LOW>, /*disp_rdma0 */
			<GIC_SPI 193 IRQ_TYPE_LEVEL_LOW>, /*disp_rdma1 */
			<GIC_SPI 194 IRQ_TYPE_LEVEL_LOW>, /*disp_rdma2 */
			<GIC_SPI 195 IRQ_TYPE_LEVEL_LOW>, /*disp_wdma0 */
			<GIC_SPI 196 IRQ_TYPE_LEVEL_LOW>, /*disp_wdma1 */
			<GIC_SPI 197 IRQ_TYPE_LEVEL_LOW>, /*disp_color0 */
			<GIC_SPI 198 IRQ_TYPE_LEVEL_LOW>, /*disp_color1 */
			<GIC_SPI 199 IRQ_TYPE_LEVEL_LOW>, /*disp_ccorr0 */
			<GIC_SPI 200 IRQ_TYPE_LEVEL_LOW>, /*disp_ccorr1 */
			<GIC_SPI 201 IRQ_TYPE_LEVEL_LOW>, /*disp_aal0 */
			<GIC_SPI 202 IRQ_TYPE_LEVEL_LOW>, /*disp_aal1 */
			<GIC_SPI 203 IRQ_TYPE_LEVEL_LOW>, /*disp_gamma0 */
			<GIC_SPI 204 IRQ_TYPE_LEVEL_LOW>, /*disp_gamma1 */
			<GIC_SPI 205 IRQ_TYPE_LEVEL_LOW>, /*disp_od */
			<GIC_SPI 206 IRQ_TYPE_LEVEL_LOW>, /*disp_dither0 */
			<GIC_SPI 207 IRQ_TYPE_LEVEL_LOW>, /*disp_dither1 */
			<GIC_SPI 0 IRQ_TYPE_LEVEL_LOW>, /*disp_ufoe */
			<GIC_SPI 0 IRQ_TYPE_LEVEL_LOW>, /*disp_dsi_dsc */
			<GIC_SPI 0 IRQ_TYPE_LEVEL_LOW>,   /*disp_split */
			<GIC_SPI 210 IRQ_TYPE_LEVEL_LOW>, /*disp_dsi0 */
			<GIC_SPI 211 IRQ_TYPE_LEVEL_LOW>, /*disp_dsi1 */
			<GIC_SPI 212 IRQ_TYPE_LEVEL_LOW>, /*disp_dpi0 */
			<GIC_SPI 0 IRQ_TYPE_LEVEL_LOW>, /*disp_pwm */
			<GIC_SPI 177 IRQ_TYPE_LEVEL_LOW>, /*disp_mutex */
			<GIC_SPI 214 IRQ_TYPE_LEVEL_LOW>, /*disp_smi_larb0 */
			<GIC_SPI 209 IRQ_TYPE_LEVEL_LOW>, /*disp_smi_larb4 */
			<GIC_SPI 0 IRQ_TYPE_LEVEL_LOW>, /*disp_smi_commom*/
			<GIC_SPI 0 IRQ_TYPE_LEVEL_LOW>, /*mipitx0 */
			<GIC_SPI 0 IRQ_TYPE_LEVEL_LOW>; /*mipitx1 */

		clocks = <&mmsys MMSYS_SMI_COMMON>,
			 <&mmsys MMSYS_SMI_LARB0>,
			 <&mmsys MMSYS_SMI_LARB4>,
			 <&mmsys MMSYS_DISP_OVL0>,
			 <&mmsys MMSYS_DISP_OVL1>,
			 <&mmsys MMSYS_DISP_OVL0_2L>,
			 <&mmsys MMSYS_DISP_OVL1_2L>,
			 <&mmsys MMSYS_DISP_RDMA0>,
			 <&mmsys MMSYS_DISP_RDMA1>,
			 <&mmsys MMSYS_DISP_RDMA2>,
			 <&mmsys MMSYS_DISP_WDMA0>,
			 <&mmsys MMSYS_DISP_WDMA1>,
			 <&mmsys MMSYS_DISP_COLOR0>,
			 <&mmsys MMSYS_DISP_COLOR1>,
			 <&mmsys MMSYS_DISP_CCORR0>,
			 <&mmsys MMSYS_DISP_CCORR1>,
			 <&mmsys MMSYS_DISP_AAL0>,
			 <&mmsys MMSYS_DISP_AAL1>,
			 <&mmsys MMSYS_DISP_GAMMA0>,
			 <&mmsys MMSYS_DISP_GAMMA1>,
			 <&mmsys MMSYS_DISP_OD>,
			 <&mmsys MMSYS_DISP_DITHER0>,
			 <&mmsys MMSYS_DISP_DITHER1>,
			 <&mmsys MMSYS_DISP_UFOE>,
			 <&mmsys MMSYS_DISP_DSC>,
			 <&mmsys MMSYS_DISP_SPLIT>,
			 <&mmsys MMSYS_DSI0_MM_CLOCK>,
			 <&mmsys MMSYS_DSI0_INTERFACE_CLOCK>,
			 <&mmsys MMSYS_DSI1_MM_CLOCK>,
			 <&mmsys MMSYS_DSI1_INTERFACE_CLOCK>,
			 <&mmsys MMSYS_DPI_MM_CLOCK>,
			 <&mmsys MMSYS_DPI_INTERFACE_CLOCK>,
			 <&mmsys MMSYS_DISP_OVL0_MOUT_CLOCK>,
			 <&infrasys INFRACFG_AO_DISP_PWM_CG>,
			 <&scpsys SCP_SYS_DIS>,
			 <&topckgen TOP_MUX_DPI0>,
			 <&topckgen TOP_TVDPLL_D2>,
			 <&topckgen TOP_TVDPLL_D4>,
			 <&topckgen TOP_TVDPLL_D8>,
			 <&topckgen TOP_TVDPLL_D16>,
			 <&topckgen TOP_TVDPLL_CK>,
			 <&topckgen TOP_MUX_DISP_PWM>,
			 <&clk26m>,
			 <&topckgen TOP_UNIVPLL2_D4>,
			 <&topckgen TOP_OSC_D4>,
			 <&topckgen TOP_OSC_D8>,
			<&topckgen TOP_MUX_MM>,
			<&topckgen TOP_VENCPLL_CK>,
			<&topckgen TOP_SYSPLL2_D2>;

		clock-names =   "DISP0_SMI_COMMON",
				"DISP0_SMI_LARB0",
				"DISP0_SMI_LARB4",
				"DISP0_DISP_OVL0",
				"DISP0_DISP_OVL1",
				"DISP0_DISP_OVL0_2L",
				"DISP0_DISP_OVL1_2L",
				"DISP0_DISP_RDMA0",
				"DISP0_DISP_RDMA1",
				"DISP0_DISP_RDMA2",
				"DISP0_DISP_WDMA0",
				"DISP0_DISP_WDMA1",
				"DISP0_DISP_COLOR",
				"DISP0_DISP_COLOR1",
				"DISP0_DISP_CCORR",
				"DISP0_DISP_CCORR1",
				"DISP0_DISP_AAL",
				"DISP0_DISP_AAL1",
				"DISP0_DISP_GAMMA",
				"DISP0_DISP_GAMMA1",
				"DISP0_DISP_OD",
				"DISP0_DISP_DITHER",
				"DISP0_DISP_DITHER1",
				"DISP0_DISP_UFOE",
				"DISP0_DISP_DSC",
				"DISP0_DISP_SPLIT",
				"DISP1_DSI0_MM_CLOCK",
				"DISP1_DSI0_INTERFACE_CLOCK",
				"DISP1_DSI1_MM_CLOCK",
				"DISP1_DSI1_INTERFACE_CLOCK",
				"DISP1_DPI_MM_CLOCK",
				"DISP1_DPI_INTERFACE_CLOCK",
				"DISP1_DISP_OVL0_MOUT",
				"DISP_PWM",
				"DISP_MTCMOS_CLK",
				"MUX_DPI0",
				"TVDPLL_D2",
				"TVDPLL_D4",
				"TVDPLL_D8",
				"TVDPLL_D16",
				"DPI_CK",
				"MUX_PWM",
				"CLK26M",
				"UNIVPLL2_D4",
				"ULPOSC_D4",
				"ULPOSC_D8",
				"MUX_MM",
				"MM_VENCPLL",
				"SYSPLL2_D2";
	};

	mhl:mhl@0 {
		compatible = "mediatek,extd_dev";
	};

	mdp_rdma0@14001000 {
		compatible = "mediatek,mdp_rdma0";
		reg = <0 0x14001000 0 0x1000>;
		interrupts = <GIC_SPI 178 IRQ_TYPE_LEVEL_LOW>;
		clocks = <&mmsys MMSYS_MDP_RDMA0>;
		clock-names = "MDP_RDMA0";
	};

	mdp_rdma1@14002000 {
		compatible = "mediatek,mdp_rdma1";
		reg = <0 0x14002000 0 0x1000>;
		interrupts = <GIC_SPI 179 IRQ_TYPE_LEVEL_LOW>;
		clocks = <&mmsys MMSYS_MDP_RDMA1>;
		clock-names = "MDP_RDMA1";
	};

	mdp_rsz0@14003000 {
		compatible = "mediatek,mdp_rsz0";
		reg = <0 0x14003000 0 0x1000>;
		interrupts = <GIC_SPI 180 IRQ_TYPE_LEVEL_LOW>;
		clocks = <&mmsys MMSYS_MDP_RSZ0>;
		clock-names = "MDP_RSZ0";
	};

	mdp_rsz1@14004000 {
		compatible = "mediatek,mdp_rsz1";
		reg = <0 0x14004000 0 0x1000>;
		interrupts = <GIC_SPI 181 IRQ_TYPE_LEVEL_LOW>;
		clocks = <&mmsys MMSYS_MDP_RSZ1>;
		clock-names = "MDP_RSZ1";
	};

	mdp_rsz2@14005000 {
		compatible = "mediatek,mdp_rsz2";
		reg = <0 0x14005000 0 0x1000>;
		interrupts = <GIC_SPI 182 IRQ_TYPE_LEVEL_LOW>;
		clocks = <&mmsys MMSYS_MDP_RSZ2>;
		clock-names = "MDP_RSZ2";
	};

	mdp_wdma@14006000 {
		compatible = "mediatek,mdp_wdma";
		reg = <0 0x14006000 0 0x1000>;
		interrupts = <GIC_SPI 185 IRQ_TYPE_LEVEL_LOW>;
		clocks = <&mmsys MMSYS_MDP_WDMA>;
		clock-names = "MDP_WDMA";
	};

	mdp_wrot0@14007000 {
		compatible = "mediatek,mdp_wrot0";
		reg = <0 0x14007000 0 0x1000>;
		interrupts = <GIC_SPI 186 IRQ_TYPE_LEVEL_LOW>;
		clocks = <&mmsys MMSYS_MDP_WROT0>;
		clock-names = "MDP_WROT0";
	};

	mdp_wrot1@14008000 {
		compatible = "mediatek,mdp_wrot1";
		reg = <0 0x14008000 0 0x1000>;
		interrupts = <GIC_SPI 187 IRQ_TYPE_LEVEL_LOW>;
		clocks = <&mmsys MMSYS_MDP_WROT1>;
		clock-names = "MDP_WROT1";
	};

	mdp_tdshp@14009000 {
		compatible = "mediatek,mdp_tdshp";
		reg = <0 0x14009000 0 0x1000>;
		interrupts = <GIC_SPI 183 IRQ_TYPE_LEVEL_LOW>;
		clocks = <&mmsys MMSYS_MDP_TDSHP>;
		clock-names = "MDP_TDSHP";
	};

	mdp_color@1400a000 {
		compatible = "mediatek,mdp_color";
		reg = <0 0x1400a000 0 0x1000>;
		interrupts = <GIC_SPI 184 IRQ_TYPE_LEVEL_LOW>;
		clocks = <&mmsys MMSYS_MDP_COLOR>;
		clock-names = "MDP_COLOR";
	};

	disp_ovl0@1400b000 {
		compatible = "mediatek,disp_ovl0";
		reg = <0 0x1400b000 0 0x1000>;
		interrupts = <GIC_SPI 188 IRQ_TYPE_LEVEL_LOW>;
	};

	disp_ovl1@1400c000 {
		compatible = "mediatek,disp_ovl1";
		reg = <0 0x1400c000 0 0x1000>;
		interrupts = <GIC_SPI 189 IRQ_TYPE_LEVEL_LOW>;
	};

	disp_ovl0_2l@1400d000 {
		compatible = "mediatek,disp_ovl0_2l";
		reg = <0 0x1400d000 0 0x1000>;
		interrupts = <GIC_SPI 190 IRQ_TYPE_LEVEL_LOW>;
	};

	disp_ovl1_2l@1400e000 {
		compatible = "mediatek,disp_ovl1_2l";
		reg = <0 0x1400e000 0 0x1000>;
		interrupts = <GIC_SPI 191 IRQ_TYPE_LEVEL_LOW>;
	};

	disp_rdma0@1400f000 {
		compatible = "mediatek,disp_rdma0";
		reg = <0 0x1400f000 0 0x1000>;
		interrupts = <GIC_SPI 192 IRQ_TYPE_LEVEL_LOW>;
	};

	disp_rdma1@14010000 {
		compatible = "mediatek,disp_rdma1";
		reg = <0 0x14010000 0 0x1000>;
		interrupts = <GIC_SPI 193 IRQ_TYPE_LEVEL_LOW>;
	};

	disp_rdma2@14011000 {
		compatible = "mediatek,disp_rdma2";
		reg = <0 0x14011000 0 0x1000>;
		interrupts = <GIC_SPI 194 IRQ_TYPE_LEVEL_LOW>;
	};

	disp_wdma0@14012000 {
		compatible = "mediatek,disp_wdma0";
		reg = <0 0x14012000 0 0x1000>;
		interrupts = <GIC_SPI 195 IRQ_TYPE_LEVEL_LOW>;
	};

	disp_wdma1@14013000 {
		compatible = "mediatek,disp_wdma1";
		reg = <0 0x14013000 0 0x1000>;
		interrupts = <GIC_SPI 196 IRQ_TYPE_LEVEL_LOW>;
	};

	disp_color0@14014000 {
		compatible = "mediatek,disp_color0";
		reg = <0 0x14014000 0 0x1000>;
		interrupts = <GIC_SPI 197 IRQ_TYPE_LEVEL_LOW>;
	};

	disp_color1@14015000 {
		compatible = "mediatek,disp_color1";
		reg = <0 0x14015000 0 0x1000>;
		interrupts = <GIC_SPI 198 IRQ_TYPE_LEVEL_LOW>;
	};

	disp_ccorr0@14016000 {
		compatible = "mediatek,disp_ccorr0";
		reg = <0 0x14016000 0 0x1000>;
		interrupts = <GIC_SPI 199 IRQ_TYPE_LEVEL_LOW>;
	};

	disp_ccorr1@14017000 {
		compatible = "mediatek,disp_ccorr1";
		reg = <0 0x14017000 0 0x1000>;
		interrupts = <GIC_SPI 200 IRQ_TYPE_LEVEL_LOW>;
	};

	disp_aal0:disp_aal0@14018000 {
		compatible = "mediatek,disp_aal0";
		reg = <0 0x14018000 0 0x1000>;
		interrupts = <GIC_SPI 201 IRQ_TYPE_LEVEL_LOW>;
		aal_support = <1>;
	};

	disp_aal1@14019000 {
		compatible = "mediatek,disp_aal1";
		reg = <0 0x14019000 0 0x1000>;
		interrupts = <GIC_SPI 202 IRQ_TYPE_LEVEL_LOW>;
	};

	disp_gamma0@1401a000 {
		compatible = "mediatek,disp_gamma0";
		reg = <0 0x1401a000 0 0x1000>;
		interrupts = <GIC_SPI 203 IRQ_TYPE_LEVEL_LOW>;
	};

	disp_gamma1@1401b000 {
		compatible = "mediatek,disp_gamma1";
		reg = <0 0x1401b000 0 0x1000>;
		interrupts = <GIC_SPI 204 IRQ_TYPE_LEVEL_LOW>;
	};

	disp_od@1401c000 {
		compatible = "mediatek,disp_od";
		reg = <0 0x1401c000 0 0x400>;
		interrupts = <GIC_SPI 205 IRQ_TYPE_LEVEL_LOW>;
	};

	disp_dither0@1401d000 {
		compatible = "mediatek,disp_dither0";
		reg = <0 0x1401d000 0 0x1000>;
		interrupts = <GIC_SPI 206 IRQ_TYPE_LEVEL_LOW>;
	};

	disp_dither1@1401e000 {
		compatible = "mediatek,disp_dither1";
		reg = <0 0x1401e000 0 0x1000>;
		interrupts = <GIC_SPI 207 IRQ_TYPE_LEVEL_LOW>;
	};

	dsi_ufoe@1401f000 {
		compatible = "mediatek,dsi_ufoe";
		reg = <0 0x1401f000 0 0x1000>;
	};

	disp_dsc@14020000 {
		compatible = "mediatek,disp_dsc";
		reg = <0 0x14020000 0 0x1000>;
	};

	dsi_split@14021000 {
		compatible = "mediatek,dsi_split";
		reg = <0 0x14021000 0 0x1000>;
	};

	dsi0@14022000 {
		compatible = "mediatek,dsi0";
		reg = <0 0x14022000 0 0x1000>;
		interrupts = <GIC_SPI 210 IRQ_TYPE_LEVEL_LOW>;
	};

	dsi1@14023000 {
		compatible = "mediatek,dsi1";
		reg = <0 0x14023000 0 0x1000>;
		interrupts = <GIC_SPI 211 IRQ_TYPE_LEVEL_LOW>;
	};

	dpi0@14024000 {
		compatible = "mediatek,dpi0";
		reg = <0 0x14024000 0 0x1000>;
		interrupts = <GIC_SPI 212 IRQ_TYPE_LEVEL_LOW>;
	};

	mm_mutex@14025000 {
		compatible = "mediatek,mm_mutex";
		reg = <0 0x14025000 0 0x1000>;
	};

	smi_larb0@14026000 {
		compatible = "mediatek,smi_larb0";
		reg = <0 0x14026000 0 0x1000>;
		interrupts = <GIC_SPI 214 IRQ_TYPE_LEVEL_LOW>;
	};

	smi_larb4@14027000 {
		compatible = "mediatek,smi_larb4";
		reg = <0 0x14027000 0 0x1000>;
		interrupts = <GIC_SPI 209 IRQ_TYPE_LEVEL_LOW>;
	};

	smi_common@14028000 {
		compatible = "mediatek,smi_common";
		reg = <0 0x14028000 0 0x1000>,
					<0 0x14026000 0 0x1000>,
					<0 0x16010000 0 0x1000>,
					<0 0x1a001000 0 0x1000>,
					<0 0x17001000 0 0x1000>,
					<0 0x14027000 0 0x1000>,
					<0 0x15021000 0 0x1000>;
		clocks = <&mmsys MMSYS_SMI_COMMON>,
				<&mmsys MMSYS_SMI_LARB0>,
				<&vdecsys VDEC_LARB1>,
				<&camsys CAMSYS_LARB2_CGPDN>,
				<&vencsys VENC_GCON_SET0_LARB>,
				<&vencsys VENC_GCON_SET1_VENC>,
				<&mmsys MMSYS_SMI_LARB4>,
				<&imgsys IMG_LARB5>,
				<&scpsys SCP_SYS_VEN>,
				<&scpsys SCP_SYS_VDE>,
				<&scpsys SCP_SYS_ISP>,
				<&scpsys SCP_SYS_DIS>,
				<&scpsys SCP_SYS_CAM>;
			clock-names = "smi-common", "smi-larb0", "smi-larb1", "smi-larb2", "smi-larb3", "smi-larb3-2",
			"smi-larb4", "smi-larb5", "mtcmos-ven", "mtcmos-vde", "mtcmos-isp",
			"mtcmos-dis", "mtcmos-cam";
	};

	met_smi: met_smi@14028000 {
		compatible = "mediatek,met_smi";
		reg = <0 0x14028000 0 0x1000>,
			<0 0x14026000 0 0x1000>,
			<0 0x16010000 0 0x1000>,
			<0 0x1a001000 0 0x1000>,
			<0 0x17001000 0 0x1000>,
			<0 0x14027000 0 0x1000>,
			<0 0x15021000 0 0x1000>;
		clocks = <&mmsys MMSYS_SMI_COMMON>,
			<&mmsys MMSYS_SMI_LARB0>,
			<&vdecsys VDEC_LARB1>,
			<&camsys CAMSYS_LARB2_CGPDN>,
			<&vencsys VENC_GCON_SET0_LARB>,
			<&vencsys VENC_GCON_SET1_VENC>,
			<&mmsys MMSYS_SMI_LARB4>,
			<&imgsys IMG_LARB5>,
			<&scpsys SCP_SYS_VEN>,
			<&scpsys SCP_SYS_VDE>,
			<&scpsys SCP_SYS_ISP>,
			<&scpsys SCP_SYS_DIS>,
			<&scpsys SCP_SYS_CAM>;
			clock-names = "smi-common", "smi-larb0", "smi-larb1", "smi-larb2", "smi-larb3", "smi-larb3-2",
			"smi-larb4", "smi-larb5", "mtcmos-ven", "mtcmos-vde", "mtcmos-isp",
			"mtcmos-dis", "mtcmos-cam";
	};

	mmsys_vad@14029000 {
		compatible = "mediatek,mmsys_vad";
		reg = <0 0x14029000 0 0x1000>;
	};

	mmsys_dfp@1402a000 {
		compatible = "mediatek,mmsys_dfp";
		reg = <0 0x1402a000 0 0x1000>;
	};

	imgsys: imgsys_config@15020000 {
		compatible = "mediatek,imgsys_config";
		reg = <0 0x15020000 0 0x1000>;
		#clock-cells = <1>;
		/* Camera CCF */
		clocks = <&scpsys SCP_SYS_DIS>,
			<&mmsys MMSYS_SMI_COMMON>,
			<&scpsys SCP_SYS_ISP>,
			<&scpsys SCP_SYS_CAM>,
			<&imgsys IMG_LARB5>,
			<&imgsys IMG_DIP>,
			<&imgsys IMG_RSC>,
			<&camsys CAMSYS_LARB2_CGPDN>,
			<&camsys CAMSYS_CAMSYS_CGPDN>,
			<&camsys CAMSYS_CAMTG_CGPDN>,
			<&camsys CAMSYS_SENINF_CGPDN>,
			<&camsys CAMSYS_CAMSV0_CGPDN>,
			<&camsys CAMSYS_CAMSV1_CGPDN>,
			<&camsys CAMSYS_CAMSV2_CGPDN>,
			<&camsys CAMSYS_TSF_CGPDN>;
		clock-names = "ISP_SCP_SYS_DIS",
			"ISP_MMSYS_SMI_COMMON",
			"ISP_SCP_SYS_ISP",
			"ISP_SCP_SYS_CAM",
			"ISP_IMG_LARB5",
			"ISP_IMG_DIP",
			"ISP_IMG_RSC",
			"ISP_CAMSYS_LARB2_CGPDN",
			"ISP_CAMSYS_CAMSYS_CGPDN",
			"ISP_CAMSYS_CAMTG_CGPDN",
			"ISP_CAMSYS_SENINF_CGPDN",
			"ISP_CAMSYS_CAMSV0_CGPDN",
			"ISP_CAMSYS_CAMSV1_CGPDN",
			"ISP_CAMSYS_CAMSV2_CGPDN",
			"ISP_CAMSYS_TSF_CGPDN";
	};

	smi_larb5@15021000 {
		compatible = "mediatek,smi_larb5";
		reg = <0 0x15021000 0 0x1000>;
		interrupts = <GIC_SPI 237 IRQ_TYPE_LEVEL_LOW>;
	};

	/* this device node is added manually for dip use */
	dip_a@15022000 {
		compatible = "mediatek,dip_a";
		reg = <0 0x15022000 0 0x2800>;
		interrupts = <GIC_SPI 238 IRQ_TYPE_LEVEL_LOW>;
	};

	dip_a0@15022000 {
		compatible = "mediatek,dip_a0";
		reg = <0 0x15022000 0 0x1000>;
		interrupts = <GIC_SPI 238 IRQ_TYPE_LEVEL_LOW>;
	};

	dip_a1@15023000 {
		compatible = "mediatek,dip_a1";
		reg = <0 0x15023000 0 0x1000>;
	};

	dip_a2@15024000 {
		compatible = "mediatek,dip_a2";
		reg = <0 0x15024000 0 0x1000>;
	};

	img_vad@15027000 {
		compatible = "mediatek,img_vad";
		reg = <0 0x15027000 0 0x1000>;
	};

	dpe@15028000 {
		compatible = "mediatek,dpe";
		reg = <0 0x15028000 0 0x1000>;
		interrupts = <GIC_SPI 240 IRQ_TYPE_LEVEL_LOW>;
		clocks = <&scpsys SCP_SYS_DIS>,
			<&mmsys MMSYS_SMI_COMMON>,
			<&scpsys SCP_SYS_ISP>,
			<&imgsys IMG_LARB5>,
			<&imgsys IMG_DPE>;
		clock-names = "DPE_CG_SCP_SYS_DIS",
			"DPE_CG_MM_SMI_COMMON",
			"DPE_CG_SCP_SYS_ISP",
			"DPE_CG_IMG_LARB5",
			"DPE_CG_IMG_DPE";
	};

	rsc@15029000 {
		compatible = "mediatek,rsc";
		reg = <0 0x15029000 0 0x1000>;
		interrupts = <GIC_SPI 242 IRQ_TYPE_LEVEL_LOW>;
	};

	fd@1502b000 {
		compatible = "mediatek,fd";
		reg = <0 0x1502b000 0 0x1000>;
		interrupts = <GIC_SPI 239 IRQ_TYPE_LEVEL_LOW>;
		clocks = <&scpsys SCP_SYS_DIS>,
			<&mmsys MMSYS_SMI_COMMON>,
			<&scpsys SCP_SYS_ISP>,
			<&imgsys IMG_LARB5>,
			<&imgsys IMG_FDVT>;
		clock-names = "FD_CG_SCP_SYS_DIS",
			"FD_CG_MM_SMI_COMMON",
			"FD_CG_SCP_SYS_ISP",
			"FD_CG_IMG_LARB5",
			"FD_CG_IMG_FD";
	};

	gepf@1502c000 {
		compatible = "mediatek,gepf";
		reg = <0 0x1502c000 0 0x1000>;
		interrupts = <GIC_SPI 241 IRQ_TYPE_LEVEL_LOW>;
	};

	img_dfp@1502e000 {
		compatible = "mediatek,img_dfp";
		reg = <0 0x1502e000 0 0x1000>;
	};

	vdecsys: vdec_gcon@16000000 {
		compatible = "mediatek,vdec_gcon";
		reg = <0 0x16000000 0 0x10000>;
		clocks =
				<&mmsys MMSYS_SMI_COMMON>,
				<&vdecsys VDEC_VDEC>,
				<&vdecsys VDEC_LARB1>,
				<&vencsys VENC_GCON_SET1_VENC>,
				<&vencsys VENC_GCON_SET0_LARB>,
				<&topckgen TOP_MUX_VDEC>,
				<&topckgen TOP_SYSPLL1_D2>,
				<&topckgen TOP_SYSPLL1_D4>,
				<&scpsys SCP_SYS_VDE>,
				<&scpsys SCP_SYS_VEN>,
				<&scpsys SCP_SYS_DIS>;
		clock-names =
				"MT_CG_DISP0_SMI_COMMON",
				"MT_CG_VDEC0_VDEC",
				"MT_CG_VDEC1_LARB",
				"MT_CG_VENC_VENC",
				"MT_CG_VENC_LARB",
				"MT_CG_TOP_MUX_VDEC",
				"MT_CG_TOP_SYSPLL1_D2",
				"MT_CG_TOP_SYSPLL1_D4",
				"MT_SCP_SYS_VDE",
				"MT_SCP_SYS_VEN",
				"MT_SCP_SYS_DIS";
		#clock-cells = <1>;
	};

	smi_larb1@16010000 {
		compatible = "mediatek,smi_larb1";
		reg = <0 0x16010000 0 0x10000>;
		interrupts = <GIC_SPI 220 IRQ_TYPE_LEVEL_LOW>;
	};

	vdec_full_top: vdec@16020000 {
		compatible = "mediatek,vdec";
		reg = <0 0x16020000 0 0x10000>;
		interrupts = <GIC_SPI 219 IRQ_TYPE_LEVEL_LOW>;
	};

	vencsys: venc_gcon@17000000 {
		compatible = "mediatek,venc_gcon";
		reg = <0 0x17000000 0 0x1000>;
		#clock-cells = <1>;
	};

	smi_larb3@17001000 {
		compatible = "mediatek,smi_larb3";
		reg = <0 0x17001000 0 0x1000>;
		interrupts = <GIC_SPI 216 IRQ_TYPE_LEVEL_LOW>;
	};

	venc@17002000 {
		compatible = "mediatek,venc";
		reg = <0 0x17002000 0 0x1000>;
		interrupts = <GIC_SPI 215 IRQ_TYPE_LEVEL_LOW>;
	};

	venc_jpg@17003000 {
		compatible = "mediatek,venc_jpg";
		reg =	<0 0x17003000 0 0x1000>,
			<0 0x17004000 0 0x1000>;
		interrupts =	<GIC_SPI 217 IRQ_TYPE_LEVEL_LOW>,
				<GIC_SPI 218 IRQ_TYPE_LEVEL_LOW>;
			clocks =
				<&mmsys MMSYS_SMI_COMMON>,
				<&scpsys SCP_SYS_DIS>,
				<&scpsys SCP_SYS_VEN>,
				<&vencsys VENC_GCON_SET0_LARB>,
				<&vencsys VENC_GCON_SET2_JPGENC>,
				<&vencsys VENC_GCON_SET3_JPGDEC>;

			clock-names =
				"MT_CG_SMI_COMMON",
				"MT_CG_SCP_SYS_MM0",
				"MT_CG_SCP_SYS_VEN",
				"MT_CG_VENC_LARB",
				"MT_CG_VENC_JPGENC",
				"MT_CG_VENC_JPGDEC";
	};

	consys: consys@18070000 {
		compatible = "mediatek,mt6757-consys";
		#address-cells = <2>;
		#size-cells = <2>;
		reg = <0 0x18070000 0 0x0200>,  /*CONN_MCU_CONFIG_BASE */
			<0 0x10007000 0 0x0100>,  /*AP_RGU_BASE */
			<0 0x10000000 0 0x2000>,  /*TOPCKGEN_BASE */
			<0 0x10006000 0 0x1000>;  /*SPM_BASE */
		interrupts = <GIC_SPI 266 IRQ_TYPE_LEVEL_LOW>, /*BGF_EINT */
			<GIC_SPI 268 IRQ_TYPE_LEVEL_LOW>; /*WDT_EINT */
		clocks = <&scpsys SCP_SYS_CONN>;
		clock-names = "conn";
	};

	wifi@180f0000 {
		compatible = "mediatek,wifi";
		reg = <0 0x180f0000 0 0x005c>;
		interrupts = <GIC_SPI 267 IRQ_TYPE_LEVEL_LOW>;
		clocks = <&infrasys INFRACFG_AO_AP_DMA_CG>;
		clock-names = "wifi-dma";
	};

	camsys: camsys_config@1a000000  {
		compatible = "mediatek,camsys_config";
		reg = <0 0x1a000000  0 0x1000>;
		#clock-cells = <1>;
	};

	smi_larb2@1a001000 {
		compatible = "mediatek,smi_larb2";
		reg = <0 0x1a001000 0 0x1000>;
		interrupts = <GIC_SPI 233 IRQ_TYPE_LEVEL_LOW>;
	};

	cam@1a003000 {
		compatible = "mediatek,cam";
		reg = <0 0x1a003000 0 0x1000>;
		interrupts = <GIC_SPI 222 IRQ_TYPE_LEVEL_LOW>;
	};

	cama@1a004000  {
		compatible = "mediatek,cama";
		reg = <0 0x1a004000  0 0x1000>;
		interrupts = <GIC_SPI 223 IRQ_TYPE_LEVEL_LOW>;
	};

	camb@1a005000 {
		compatible = "mediatek,camb";
		reg = <0 0x1a005000 0 0x1000>;
		interrupts = <GIC_SPI 224 IRQ_TYPE_LEVEL_LOW>;
	};

	cam_set@1a00b000 {
		compatible = "mediatek,cam_set";
		reg = <0 0x1a00b000 0 0x1000>;
	};

	cama_set@1a00c000 {
		compatible = "mediatek,cama_set";
		reg = <0 0x1a00c000 0 0x1000>;
	};

	camb_set@1a00d000 {
		compatible = "mediatek,camb_set";
		reg = <0 0x1a00d000 0 0x1000>;
	};

	cam_inner@1a013000 {
		compatible = "mediatek,cam_inner";
		reg = <0 0x1a013000 0 0x1000>;
	};

	cama_inner@1a014000 {
		compatible = "mediatek,cama_inner";
		reg = <0 0x1a014000 0 0x1000>;
	};

	camb_inner@1a015000  {
		compatible = "mediatek,camb_inner";
		reg = <0 0x1a015000  0 0x1000>;
	};

	cam_clear@1a01b000 {
		compatible = "mediatek,cam_clear";
		reg = <0 0x1a01b000 0 0x1000>;
	};

	cama_clear@1a01c000 {
		compatible = "mediatek,cama_clear";
		reg = <0 0x1a01c000 0 0x1000>;
	};

	camb_clear@1a01d000 {
		compatible = "mediatek,camb_clear";
		reg = <0 0x1a01d000 0 0x1000>;
	};

	kd_camera_hw1:kd_camera_hw1@1a040000 {
		compatible = "mediatek,camera_hw";
		reg = <0 0x1a040000 0 0x1000>;  /* SENINF_ADDR */

		/* Camera Common Clock Framework (CCF) */
		clocks = <&topckgen TOP_MUX_CAMTG>,
		<&topckgen TOP_MUX_SCAM>,
		<&topckgen TOP_UNIVPLL_192M_D4>,
		<&topckgen TOP_UNIVPLL2_D2>;
		clock-names = "TOP_CAMTG_SEL","TOP_MUX_SCAM","TOP_UNIVPLL_192M_D4","TOP_UNIVPLL2_D2";
		vcamio-supply = <&mt_pmic_vcamio_ldo_reg>;
	};

	kd_camera_hw2:kd_camera_hw2@1a040000 {
		compatible = "mediatek,camera_hw2";
		reg = <0 0x1a040000 0 0x1000>;  /* SENINF_ADDR */
	};

	seiinfa@1a040000 {
		compatible = "mediatek,seiinfa";
		reg = <0 0x1a040000 0 0x1000>;
	};

	seiinfb@1a041000 {
		compatible = "mediatek,seiinfb";
		reg = <0 0x1a041000 0 0x1000>;
	};

	camsva@1a050000 {
		compatible = "mediatek,camsva";
		reg = <0 0x1a050000 0 0x1000>;
		interrupts = <GIC_SPI 228 IRQ_TYPE_LEVEL_LOW>;
	};

	camsvb@1a051000 {
		compatible = "mediatek,camsvb";
		reg = <0 0x1a051000 0 0x1000>;
		interrupts = <GIC_SPI 227 IRQ_TYPE_LEVEL_LOW>;
	};

	camsvc@1a052000 {
		compatible = "mediatek,camsvc";
		reg = <0 0x1a052000 0 0x1000>;
		interrupts = <GIC_SPI 230 IRQ_TYPE_LEVEL_LOW>;
	};

	camsvd@1a053000 {
		compatible = "mediatek,camsvd";
		reg = <0 0x1a053000 0 0x1000>;
		interrupts = <GIC_SPI 229 IRQ_TYPE_LEVEL_LOW>;
	};

	camsve@1a054000 {
		compatible = "mediatek,camsve";
		reg = <0 0x1a054000 0 0x1000>;
		interrupts = <GIC_SPI 232 IRQ_TYPE_LEVEL_LOW>;
	};

	camsvf@1a055000 {
		compatible = "mediatek,camsvf";
		reg = <0 0x1a055000 0 0x1000>;
		interrupts = <GIC_SPI 231 IRQ_TYPE_LEVEL_LOW>;
	};

	tsf@1a057000 {
		compatible = "mediatek,tsf";
		reg = <0 0x1a057000 0 0x1000>;
		interrupts = <GIC_SPI 234 IRQ_TYPE_LEVEL_LOW>;
		clocks = <&scpsys SCP_SYS_DIS>,
			<&mmsys MMSYS_SMI_COMMON>,
			<&scpsys SCP_SYS_CAM>,
			<&camsys CAMSYS_LARB2_CGPDN>,
			<&camsys CAMSYS_TSF_CGPDN>;
		clock-names = "TSF_SCP_SYS_DIS",
			"TSF_MMSYS_SMI_COMMON",
			"TSF_SCP_SYS_CAM",
			"TSF_CAMSYS_LARB2_CGPDN",
			"TSF_CAMSYS_TSF_CGPDN";
	};

	ccu@1a057400 {
		compatible = "mediatek,ccu";
		reg = <0 0x1a057400 0 0x1000>;
		interrupts = <GIC_SPI 235 IRQ_TYPE_LEVEL_LOW>;
		ccu_hw_offset = <0x400>;
		ccu_pmem_base = <0x1a0a0000>;
		ccu_pmem_size = <0x5000>;
		ccu_dmem_base = <0x1a080000>;
		ccu_dmem_size = <0x3000>;
		ccu_dmem_offset = <0x1680>;
		ccu_log_base = <0x500>;
		ccu_log_size = <0x200>;
		ccu_hw_dump_size = <0x3c0>;
		ccu_camsys_base = <0x1a000000>;
		ccu_camsys_size = <0x1000>;
		ccu_n3d_a_base = <0x1a03ffc0>;
		ccu_n3d_a_size = <0x1000>;
		ccu_sensor_pm_size = <0x800>;
		ccu_sensor_dm_size = <0x600>;

		clocks = <&camsys CAMSYS_TSF_CGPDN>;
		clock-names = "CCU_CLK_CAM_CCU";
	};

	gpufreq {
		compatible = "mediatek,mt6757-gpufreq";
		clocks =
				<&topckgen TOP_MUX_MFG>,
				<&topckgen TOP_MMPLL_CK>,
				<&topckgen TOP_SYSPLL_D3>;
		clock-names =
				"clk_mux",
				"clk_main_parent",
				"clk_sub_parent";
		};

	usb_c_pinctrl:usb_c_pinctrl@0 {
		compatible = "mediatek,usb_c_pinctrl";
	};

	usb3_phy {
		compatible = "mediatek,usb3_phy";
		clocks = <&infrasys INFRACFG_AO_SSUSB_TOP_CG>;
		clock-names = "sssub_clk";
	};

	mt_soc_btcvsd_rx_pcm {
		compatible = "mediatek,mt_soc_btcvsd_rx_pcm";
	};

	mt_soc_btcvsd_tx_pcm {
		compatible = "mediatek,mt_soc_btcvsd_tx_pcm";
	};

	mt_soc_deep_buffer_dl_pcm {
		compatible = "mediatek,mt_soc_pcm_deep_buffer_dl";
	};

	mt_soc_ul1_pcm {
		compatible = "mediatek,mt_soc_pcm_capture";
	};

	mt_soc_voice_md1 {
		compatible = "mediatek,mt_soc_pcm_voice_md1";
	};

	mt_soc_hdmi_pcm {
		compatible = "mediatek,mt_soc_pcm_hdmi";
	};

	mt_soc_uldlloopback_pcm {
		compatible = "mediatek,mt_soc_pcm_uldlloopback";
	};

	mt_soc_i2s0_pcm {
		compatible = "mediatek,mt_soc_pcm_dl1_i2s0";
	};

	mt_soc_mrgrx_pcm {
		compatible = "mediatek,mt_soc_pcm_mrgrx";
	};

	mt_soc_mrgrx_awb_pcm {
		compatible = "mediatek,mt_soc_pcm_mrgrx_awb";
	};

	mt_soc_fm_i2s_pcm {
		compatible = "mediatek,mt_soc_pcm_fm_i2s";
	};

	mt_soc_fm_i2s_awb_pcm {
		compatible = "mediatek,mt_soc_pcm_fm_i2s_awb";
	};

	mt_soc_i2s0dl1_pcm {
		compatible = "mediatek,mt_soc_pcm_dl1_i2s0dl1";
	};

	mt_soc_dl1_awb_pcm {
		compatible = "mediatek,mt_soc_pcm_dl1_awb";
	};

	mt_soc_voice_md1_bt {
		compatible = "mediatek,mt_soc_pcm_voice_md1_bt";
	};

	mt_soc_voip_bt_out {
		compatible = "mediatek,mt_soc_pcm_dl1_bt";
	};

	mt_soc_voip_bt_in {
		compatible = "mediatek,mt_soc_pcm_bt_dai";
	};

	mt_soc_tdmrx_pcm {
		compatible = "mediatek,mt_soc_tdm_capture";
	};

	mt_soc_fm_mrgtx_pcm {
		compatible = "mediatek,mt_soc_pcm_fmtx";
	};

	mt_soc_ul2_pcm {
		compatible = "mediatek,mt_soc_pcm_capture2";
	};

	mt_soc_i2s0_awb_pcm {
		compatible = "mediatek,mt_soc_pcm_i2s0_awb";
	};

	mt_soc_voice_md2 {
		compatible = "mediatek,mt_soc_pcm_voice_md2";
	};

	mt_soc_routing_pcm {
		compatible = "mediatek,mt_soc_pcm_routing";
		/*i2s1clk-gpio = <7 6>;*/
		/*i2s1dat-gpio = <5 6>;*/
		/*i2s1mclk-gpio = <9 6>;*/
		/*i2s1ws-gpio = <6 6>;*/
	};

	mt_soc_voice_md2_bt {
		compatible = "mediatek,mt_soc_pcm_voice_md2_bt";
	};

	mt_soc_hp_impedance_pcm {
		compatible = "mediatek,mt_soc_pcm_hp_impedance";
	};

	mt_soc_codec_name {
		compatible = "mediatek,mt_soc_codec_63xx";
		use_hp_depop_flow = <0>; /* select 1: use, 0: not use */
		use_ul_260k = <0>; /* select 1: use, 0: not use */
		use_mtkaif_ver = <0>; /* select 1: 1.5, 0: 1.0*/
	};

	mt_soc_dummy_pcm {
		compatible = "mediatek,mt_soc_pcm_dummy";
	};

	mt_soc_codec_dummy_name {
		compatible = "mediatek,mt_soc_codec_dummy";
	};

	mt_soc_routing_dai_name {
		compatible = "mediatek,mt_soc_dai_routing";
	};

	mt_soc_dai_name {
		compatible = "mediatek,mt_soc_dai_stub";
	};

	mt_soc_dl2_pcm {
		compatible = "mediatek,mt_soc_pcm_dl2";
	};

	mt_soc_anc_pcm {
		compatible = "mediatek,mt_soc_pcm_anc";
	};

	mt_soc_pcm_voice_ultra {
		compatible = "mediatek,mt_soc_pcm_voice_ultra";
	};

	mt_soc_pcm_voice_usb {
		compatible = "mediatek,mt_soc_pcm_voice_usb";
	};

	mt_soc_pcm_voice_usb_echoref {
		compatible = "mediatek,mt_soc_pcm_voice_usb_echoref";
	};

	nfc:nfc@0 {
		compatible = "mediatek,nfc-gpio-v2";
		/* gpio-ven = <15>; */
		/* gpio-rst = <25>; */
		/* gpio-eint = <14>; */
		/* gpio-irq = <13>; */
		/* gpio-osc = <99>; */
	};

	gps {
		compatible = "mediatek,gps";
	};

	flashlight_core: flashlight_core {
		compatible = "mediatek,flashlight_core";
	};

	flashlights_lm3643: flashlights_lm3643 {
		compatible = "mediatek,flashlights_lm3643";
	};

	flashlights_rt5081: flashlights_rt5081 {
		compatible = "mediatek,flashlights_rt5081";
	};

	gsensor@0 {
		compatible = "mediatek,gsensor";
		/* vgsensor-supply = <&mt_pmic_vio28_ldo_reg>; */
	};

	als:als_ps@0 {
		compatible = "mediatek,als_ps";
		/* valsps-supply = <&mt_pmic_vio28_ldo_reg>; */
	};

	gyroscope:gyroscope@0 {
		compatible = "mediatek,gyroscope";
		/* vgyro-supply = <&mt_pmic_vio28_ldo_reg>; */
	};

	barometer@0 {
		compatible = "mediatek,barometer";
		/* vbarometer-supply = <&mt_pmic_vio28_ldo_reg>; */
	};

	m_baro_pl@0 {
		compatible = "mediatek,m_baro_pl";
		/* vbarometer-supply = <&mt_pmic_vio28_ldo_reg>; */
	};

	msensor@0 {
		compatible = "mediatek,msensor";
		/* vmsensor-supply = <&mt_pmic_vio28_ldo_reg>; */
	};

	irq_nfc: irq_nfc@ {
		compatible = "mediatek,irq_nfc-eint";
	};

	dsi_te: dsi_te {
		compatible = "mediatek, dsi_te-eint";
		status = "disabled";
	};

	rf_clock_buffer_ctrl:rf_clock_buffer {
		compatible = "mediatek,rf_clock_buffer";
		mediatek,clkbuf-quantity = <4>;
		mediatek,clkbuf-config = <2 0 1 1>;
		mediatek,clkbuf-driving-current = <2 2 2 2>;
	};

	irtx_pwm:irtx_pwm {
		compatible = "mediatek,irtx-pwm";
		pwm_ch = <2>;
		pwm_data_invert = <0>;
	};

	otg_iddig: otg_iddig {
		compatible = "mediatek,usb_iddig_bi_eint";
	};

	usb_boost_manager {
		compatible = "mediatek,usb_boost_manager";
		boost_period = <30>;
	};

	ssusb_ip_sleep {
		compatible = "mediatek,usb_ipsleep";
		interrupt-parent = <&eintc>;
		interrupts = <209 IRQ_TYPE_LEVEL_LOW>;
		debounce = <209 0>;
		status = "okay";
	};

	fan53528_buck_info {
		regulator-name = "ext_buck_lp4";
		regulator-min-microvolt = <350000>;
		regulator-max-microvolt = <1143750>;
		regulator-ramp-delay = <32000>;
		regulator-always-on;
	};

	/* Add dummy nodes for cust.dtsi */
	ext_buck_oc: ext_buck_oc {
		compatible = "mediatek, ext_buck_oc-eint";
		status = "disabled";
	};

	gyro: gyro {
		compatible = "mediatek, gyro-eint";
		status = "disabled";
	};

	mse: mse {
		compatible = "mediatek, mse-eint";
		status = "disabled";
	};

	eint_fusb300_det_in: eint_fusb300_det_in {
		compatible = "mediatek,fusb300-eint";
	};

	smart_pa: smart_pa {
		compatible = "mediatek, smart_pa-eint";
		status = "disabled";
	};

	chr_stat: chr_stat {
		compatible = "mediatek, chr_stat-eint";
	};

	rt-pd-manager {
		compatible = "mediatek,rt-pd-manager";
		rt,pd_vconn_gpio = <&pio 42 0x0>;
		rt,pd_vconn_gpio_x = <42>;
	};

	cam_cal_drv{
		compatible = "mediatek,cam_cal_drv";
		main_bus = <2>;
		sub_bus = <4>;
	};

	charger: charger {
		compatible = "mediatek,charger";
		algorithm_name = "SwitchCharging";
		enable_sw_jeita;
		/* enable_pe_plus; */
		/* enable_pe_2; */
		/* enable_pe_3; */

		/* common */
		battery_cv = <4430000>;
		max_charger_voltage = <6300000>;
		min_charger_voltage = <4600000>;

		/* charging current */
		usb_charger_current_suspend = <0>;
		usb_charger_current_unconfigured = <70000>;
		usb_charger_current_configured = <500000>;
		usb_charger_current = <500000>;
		ac_charger_current = <2050000>;
		ac_charger_input_current = <2200000>;
		non_std_ac_charger_current = <800000>;
		charging_host_charger_current = <1000000>;
		ta_ac_charger_current = <3000000>;

		/* sw jeita */
		jeita_temp_above_t4_cv_voltage = <4400000>;
		jeita_temp_t3_to_t4_cv_voltage = <4400000>;
		jeita_temp_t2_to_t3_cv_voltage = <4400000>;
		jeita_temp_t1_to_t2_cv_voltage = <4400000>;
		jeita_temp_t0_to_t1_cv_voltage = <4400000>;
		jeita_temp_below_t0_cv_voltage = <4400000>;
		temp_t4_threshold = <55>;
		temp_t4_thres_minus_x_degree = <53>;
		temp_t3_threshold = <45>;
		temp_t3_thres_minus_x_degree = <43>;
		temp_t2_threshold = <10>;
		temp_t2_thres_plus_x_degree = <12>;
		temp_t1_threshold = <5>;
		temp_t1_thres_plus_x_degree = <7>;
		temp_t0_threshold = <0>;
		temp_t0_thres_plus_x_degree = <2>;
		temp_neg_10_threshold = <0>;

		/* battery temperature protection */
		enable_min_charge_temperature;
		min_charge_temperature = <0>;
		min_charge_temperature_plus_x_degree = <2>;
		max_charge_temperature = <55>;
		max_charge_temperature_minus_x_degree = <53>;

		/* PE 2.0 */
		pe20_ichg_level_threshold = <1000>;
		ta_start_battery_soc = <0>;
		ta_stop_battery_soc = <85>;

		/* dual charger */
		chg1_ta_ac_charger_current = <1500000>;
		chg2_ta_ac_charger_current = <1500000>;

		/* cable measurement impedance */
		cable_imp_threshold = <699>;
		vbat_cable_imp_threshold = <3900>;

		/* bif */
		bif_threshold1 = <4250000>;
		bif_threshold2 = <4300000>;
		bif_cv_under_threshold2 = <4450000>;
	};

	rt5081_pmu_eint: rt5081_pmu_eint {
	};

	rt5081_pd: rt5081_pd_eint {
	};

	rt1711h_pd: rt1711h_pd_eint {
	};

	firmware {
		android {
			compatible = "android,firmware";
			fstab {
				compatible = "android,fstab";
#if !defined(CONFIG_SYSTEM_AS_ROOT) && !defined(CONFIG_MTK_AB_OTA_UPDATER)
				system {
					compatible = "android,system";
					dev = "/dev/block/platform/mtk-msdc.0/11230000.msdc0/by-name/system";
					type = "ext4";
					mnt_flags = "ro";
					#ifndef CONFIG_MTK_DM_VERITY_OFF
					fsmgr_flags = "wait,verify";
					#else
					fsmgr_flags = "wait";
					#endif
				};
#endif
#ifndef CONFIG_MTK_LATE_MOUNT
				vendor {
					compatible = "android,vendor";
					dev = "/dev/block/platform/mtk-msdc.0/11230000.msdc0/by-name/vendor";
					type = "ext4";
					mnt_flags = "ro";
#ifndef CONFIG_MTK_AB_OTA_UPDATER
					#ifndef CONFIG_MTK_DM_VERITY_OFF
					fsmgr_flags = "wait,verify";
					#else
					fsmgr_flags = "wait";
					#endif
#else
					#ifndef CONFIG_MTK_DM_VERITY_OFF
					fsmgr_flags = "wait,slotselect,verify";
					#else
					fsmgr_flags = "wait,slotselect";
					#endif
#endif
				};
#endif
#ifdef CONFIG_TARGET_COPY_OUT_ODM
				odm {
					compatible = "android,odm";
					dev = "/dev/block/platform/mtk-msdc.0/11230000.msdc0/by-name/odm";
					type = "ext4";
					mnt_flags = "ro";
#ifndef CONFIG_MTK_AB_OTA_UPDATER
					fsmgr_flags = "wait";
#else
					#ifndef CONFIG_MTK_DM_VERITY_OFF
					fsmgr_flags = "wait,slotselect,verify";
					#else
					fsmgr_flags = "wait,slotselect";
					#endif
#endif
				};
#endif
			};
		};
	};
	odm: odm{
		compatible = "simple-bus";
		/* reserved for overlay by odm */
	};
};

#include "cust_mt6757_msdc.dtsi"

#ifdef CONFIG_MTK_PMIC_CHIP_MT6355
#include "mt6355.dtsi"
#else
#include "mt6351.dtsi"
#endif

#ifdef CONFIG_MFD_RT5081_PMU
#include "rt5081.dtsi"
#endif
#ifdef CONFIG_TCPC_CLASS
#include "tcpc_config.dtsi"
#endif
